  %include "../defaults_com.asm"

%macro setNextStartAddress 0       ;    23
    mov bl,ch                      ; 2 0 2
    mov bh,lineTable >> 8          ; 2 0 2
    mov ah,[bx]                    ; 2 1 3
    mov al,0x0d                    ; 2 0 2
    out dx,ax                      ; 1 2 3
    mov ah,[bx+0x100]              ; 4 1 5
    dec ax                         ; 1 0 1
    out dx,ax                      ; 1 2 3
    add cx,si                      ; 2 0 2
%endMacro

  ; The timing in the inner loop is critical - an interrupt could cause a very
  ; visible glitch.
  cli

  ; Put the image data in video memory
  mov ax,0xb800
  mov es,ax
  mov ax,cs
  mov ds,ax
  mov cx,40*201
  xor di,di
  mov si,imageData
  cld
  rep movsw

  ; Mode                                                08
  ;      1 +HRES                                         0
  ;      2 +GRPH                                         0
  ;      4 +BW                                           0
  ;      8 +VIDEO ENABLE                                 8
  ;   0x10 +1BPP                                         0
  ;   0x20 +ENABLE BLINK                                 0
  mov dx,0x3d8
  mov al,0x08
  out dx,al

  ; Palette                                             00
  ;      1 +OVERSCAN B                                   0
  ;      2 +OVERSCAN G                                   0
  ;      4 +OVERSCAN R                                   0
  ;      8 +OVERSCAN I                                   0
  ;   0x10 +BACKGROUND I                                 0
  ;   0x20 +COLOR SEL                                    0
  mov dx,0x3d9
  mov al,0
  out dx,al

  mov dx,0x3d4

  ;   0xff Horizontal Total                             38
  mov ax,0x3800
  out dx,ax

  ;   0xff Horizontal Displayed                         14
  mov ax,0x1401
  out dx,ax

  ;   0xff Horizontal Sync Position                     2d
  mov ax,0x2d02
  out dx,ax

  ;   0x0f Horizontal Sync Width                        0a
  mov ax,0x0a03
  out dx,ax

  ;   0x7f Vertical Total                               3f
  mov ax,0x3f04
  out dx,ax

  ;   0x1f Vertical Total Adjust                        00
  mov ax,0x0005
  out dx,ax

  ;   0x7f Vertical Displayed                           02
  mov ax,0x0206
  out dx,ax

  ;   0x7f Vertical Sync Position                       19
  mov ax,0x1a07
  out dx,ax

  ;   0x03 Interlace Mode                               02
  mov ax,0x0208
  out dx,ax

  ;   0x1f Max Scan Line Address                        00
  mov ax,0x0009
  out dx,ax

  ; Cursor Start                                        06
  ;   0x1f Cursor Start                                  6
  ;   0x60 Cursor Mode                                   0
  mov ax,0x060a
  out dx,ax

  ;   0x1f Cursor End                                   07
  mov ax,0x070b
  out dx,ax

  ;   0x3f Start Address (H)                            00
  mov ax,0x000c
  out dx,ax

  ;   0xff Start Address (L)                            00
  mov ax,0x000d
  out dx,ax

  ;   0x3f Cursor (H)                                   03
  mov ax,0x030e
  out dx,ax

  ;   0xff Cursor (L)                                   c0
  mov ax,0xc00f
  out dx,ax


; Lines 0..198 = 199x 2-row, 1-line screens
; Line 199 = rows 0-1 of 64-row screen (visible)
;      200         2                   start of overscan
;      224        26                   start of vertical sync
;      240        42                   end of vertical sync
;      261        63                   last line of frame

  mov dl,0xda
  mov si,0  ; Increase per 2 lines in lines/256
  mov di,0  ; Frame number

frameLoop:
    ; Comment for animation
;    mov si,0x200
;    mov cx,0

  ; We now have over 62 rows (3.9ms) to do per-frame changes.
  waitForVerticalSync
  waitForNoVerticalSync

  ; During line 0 we:
  ;   set up the start address for line 1
  ;   change the vertical total to 0x01
  ;   change the horizontal total to 0x13 in the first half of the line
  ;   change the horizontal total to 0x24 in the second
  ;   change the horizontal sync position to 0x19
  waitForDisplayEnable
  mov dl,0xd4                                           ; 2 0 2   2
  mov ax,0x1300 ; 0: Horizontal total: 20 characters    ; 3 0 3   5   = length of first half-line
  out dx,ax                                             ; 1 2 3   8
  mov ax,0x1902 ; 2: Horizontal sync position: 25       ; 3 0 3  11
  out dx,ax                                             ; 1 2 3  14
  mov ax,0x0104 ; 4: Vertical total: 2 rows/frame       ; 3 0 3  17
  out dx,ax                                             ; 1 2 3  20
  times 2 nop                                           ; 1 0 1  27

  ; Set length of second part of scanline
  mov ax,0x2400 ; 0: Horizontal total: 37 characters    ; 3 0 3  30   = length of second half-line, total 57 characters
  out dx,ax                                             ; 1 2 3  33

  setNextStartAddress                                   ;    23  56   Display will be disabled at around IO 53

  ; Might want to put this back in for compatibility with faster machines - see if it makes it too slow on the XT
  mov dl,0xda                                           ; 2 0 2  58
  ; waitForDisplayDisable

  ; During lines 1..198 we:
  ;   set up the start address for the next line
  ;   change the horizontal total to 0x13 in the first half of the line
  ;   change the horizontal total to 0x24 in the second
%rep 198
    waitForDisplayEnable
    mov dl,0xd4                                           ; 2 0 2   2
    mov ax,0x1300 ; 0: Horizontal total: 20 characters    ; 3 0 3   5   = length of first half-line
    out dx,ax                                             ; 1 2 3   8
    times 14 nop                                          ; 1 0 1  27

    ; Set length of second part of scanline
    mov ah,0x24   ; 0: Horizontal total: 37 characters    ; 2 0 2  29   = length of second half-line, total 57 characters
    out dx,ax                                             ; 1 2 3  32

    setNextStartAddress                                   ;    23  55   Display will be disabled at around IO 53

    ; Might want to put this back in for compatibility with faster machines - see if it makes it too slow on the XT
    mov dl,0xda                                           ; 2 0 2  58
    ; waitForDisplayDisable
%endrep

  ; During line 199 we:
  ;   set up the start address for line 0
  ;   change the vertical total to 0x3f
  ;   change the horizontal total to 0x13 in the first half of the line
  ;   change the horizontal total to 0x24 in the second
  waitForDisplayEnable
  mov dl,0xd4                                           ; 2 0 2   2
  mov ax,0x1300 ; 0: Horizontal total: 20 characters    ; 3 0 3   5   = length of first half-line
  out dx,ax                                             ; 1 2 3   8
  mov ax,0x3f04 ; 4: Vertical total: 64 rows/frame      ; 3 0 3  11
  out dx,ax                                             ; 1 2 3  14
  mov cx,bp     ; Initial offset in lines/256           ; 2 0 2  16
  times 6 nop                                           ; 1 0 1  27

  ; Set length of second part of scanline
  mov ax,0x2400 ; 0: Horizontal total: 37 characters    ; 3 0 3  30   = length of second half-line, total 57 characters
  out dx,ax                                             ; 1 2 3  33

  setNextStartAddress                                   ;    23  56   Display will be disabled at around IO 53

  ; Might want to put this back in for compatibility with faster machines - see if it makes it too slow on the XT
  mov dl,0xda                                           ; 2 0 2  58
  ; waitForDisplayDisable


  ; During line 200 we:
  ;   change the horizontal total to 0x38
  ;   change the horizontal sync position to 0x2d
  ; Can't use waitForDisplayEnable here because it won't activate again until line 0
  times 18 nop
  mov dl,0xd4
  mov ax,0x3800 ; 0: Horizontal total: 57 characters
  out dx,ax
  mov ax,0x2d02 ; 2: Horizontal sync position: 45
  out dx,ax

  ; Now we have about 62*76 IOs where the timing is more relaxed.

  inc si
  mov ax,si
  shr ax,1
  shr ax,1
  shr ax,1
  shr ax,1
  shr ax,1
  shr ax,1
  shr ax,1
  add si,ax
  mov ax,si
  mov di,50
  mul di
  neg ax
  mov bp,ax
  mov dx,0x3da
  add bp,0x6400

  in al,0x40
  mov bl,al
  in al,0x40
  mov bh,al
  printHex
  printNewLine

  jmp frameLoop


;  cmp di,0x200
;  jg otherStyle
;  mov dx,4
;  mov ax,0
;  div di
;  mov si,ax
;  mov dx,0x3da
;  inc di
;
;  jmp frameLoop
;otherStyle:
;  mov si,0x400
;  sub si,di
;  inc di
;  cmp di,0x400
;  jne noReset
;  mov di,1
;noReset:
;  jmp frameLoop


align 0x100
lineTable:

%assign i 0
%rep 200
  db (i*40) & 0xff
%assign i i+1
%endrep
%rep 56
  db (200*40) & 0xff
%endrep

%assign i 0
%rep 200
  db (i*40) >> 8
%assign i i+1
%endrep
%rep 56
  db (200*40) >> 8
%endrep


imageData:

  db 0x0E, 0x08, 0x00, 0x88, 0x00, 0x88, 0x00, 0x88
  db 0x00, 0x88, 0x62, 0x80, 0x05, 0x80, 0xB1, 0x84
  db 0xB1, 0x70, 0xB1, 0x48, 0xB1, 0x48, 0xB1, 0xFC
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  db 0x13, 0x08, 0x45, 0x20, 0x04, 0x04, 0x34, 0x08
  times 80 db 0x00
