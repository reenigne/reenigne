cpu 8086

  mov ax,4
  int 0x10
  mov di,spanBuffer0
  call clearSpanBuffer
  mov di,spanBuffer1
  call clearSpanBuffer
frameLoop:
  ; Update rotation angles

  mov bx,[theta]
  add bx,[dTheta]
  mov [theta],bx
  add bx,bx
  mov si,[phi]
  add si,[dPhi]
  mov [phi],si
  add si,si


  ; Compute scaled rotation matrix elements

  ; TODO: We could replace this with prescaled sin, cos, half-sin and half-cos tables at cost of additional 20kB of tables
  ;   sin*s.x
  ;   sin*s.y/2
  ;   sin/2
  ;   sin*s.y
  ;   sin

  mov ax,[sine + bx]  ; sin(theta)
  mov di,ax
  mov cx,0x7f5c  ; s.x = 99.5 * 6/5 * 16/15
  imul cx
  mov [xx],ah
  mov [xx+1],dl   ; xx = s.x*sin(theta)

  mov ax,di
  mov bp,[cosine + si] ; cos(phi)
  imul bp
  mov al,ah
  mov ah,dl
  mov cx,0x6a22  ; s.y = 99.5 * 16/15
  imul cx
  mov [yy],ah
  mov [yy+1],dl   ; yy = s.y*sin(theta)*cos(phi)

  xchg ax,di
  mov cx,[sine + si]   ; sin(phi)
  imul cx
  mov [yz],ah
  mov [yz+1],dl   ; yz = s.z*sin(theta)*sin(phi)

  mov ax,[cosine + bx]  ; cos(theta)
  mov di,ax
  neg ax
  imul cx
  mov [xz],ah
  mov [xz+1],dl   ; xz = -cos(theta)*sin(phi)

  mov ax,di
  neg bp
  mov [zz],bp     ; zz = -cos(phi)
  imul bp
  mov al,ah
  mov ah,dl
  mov bp,0x6a22
  imul bp
  mov [xy],ah
  mov [xy+1],dl   ; xy = -s.y*cos(theta)*cos(phi)

  xchg ax,di
  mov bp,0x7f5c
  imul bp
  mov [yx],ah
  mov [yx+1],dl   ; yx = s.x*cos(theta)

  mov ax,0x6a22
  imul cx
  mov [zy],ah
  mov [zy+1],dl   ; zy = s.y*sin(phi);


  ; Transform vertices to screen coordinates
  mov si,[currentShape]
  lodsb
  mov cl,al
  mov ch,0
  lodsw
  mov si,ax
  mov di,vertexBuffer
transformLoop:
  lodsw
  push si
  mov si,ax

  lodsw
  imul word[xx]
  mov bp,ax
  mov bx,dx
  lodsw
  imul word[yx]
;  add bp,ax
;  adc bx,dx
;  lodsw
;  imul word[zx]
  add ax,bp
  adc dx,bx
  stosw
  mov ax,dx
  stosw
  sub si,4

  lodsw
  imul word[xy]
  mov bp,ax
  mov bx,dx
  lodsw
  imul word[yy]
  add bp,ax
  adc bx,dx
  lodsw
  imul word[zy]
  add ax,bp
  adc dx,bx
  stosw
  mov ax,dx
  stosw
  sub si,6

  lodsw
  imul word[xz]
  mov bp,ax
  mov bx,dx
  lodsw
  imul word[yz]
  add bp,ax
  adc bx,dx
  lodsw
  imul word[zz]
  add ax,bp
  adc dx,bx
  stosw
  mov ax,dx
  stosw

  ; xx xx xx xx yy yy yy yy zz zz zz zz
  ; -c    -a    -8    -6       -3

  mov bx,[di-3]
  mov ax,[di-0x0c]
  mov dx,[di-0x0a]
  idiv bx
  mov [di-0x0c],ax
  mov ax,[di-8]
  mov dx,[di-6]
  idiv bx
  mov [di-0x08],ax

  loop transformLoop


  ; Draw faces into span buffers
  mov si,[currentShape]
  add si,3
  lodsb
  mov cl,al
  mov ch,0
  lodsw
  mov si,ax
faceLoop:
  lodsw
  mov [colour],ax
  lodsw
  push cx
  xchg ax,cx
  push cx
  mov bx,[si]
  mov di,[bx]      ; p0.x
  mov dx,[bx+4]    ; p0.y
  mov bx,[si+2]
  mov cx,[bx]      ; p1.x
  mov ax,[bx+4]    ; p1.y
  mov bx,[si+4]
  mov bp,[bx]      ; p2.x
  mov bx,[bx+4]    ; p2.y
  shr cx,1
  shr bp,1
  shr di,1
  shr dx,1
  shr ax,1
  shr bx,1

  sub cx,di        ; p1.x - p0.x
  sub bp,di        ; p2.x - p0.x
  sub ax,dx        ; p1.y - p0.y
  sub bx,dx        ; p2.y - p0.y
  imul bp          ; (p2.x - p0.x)*(p1.y - p0.y)
  mov bp,ax        ; loword((p2.x - p0.x)*(p1.y - p0.y))
  mov di,dx        ; hiword((p2.x - p0.x)*(p1.y - p0.y))
  mov ax,bx        ; p2.y - p0.y
  imul cx          ; (p2.y - p0.y)*(p1.x - p0.x)
  cmp dx,di        ; hiword((p2.y - p0.y)*(p1.x - p0.x)) <=> hiword((p2.x - p0.x)*(p1.y - p0.y))
  jg skipFace
  jl drawFace
  cmp ax,bp
  jg skipFace
drawFace:
  mov bp,2
  pop cx

drawFacePart:
  push cx
  push bp
  push si
  mov bx,[si]
  mov cx,[bx]       ; cx = a.x
  mov di,[bx+4]     ; di = a.y
  mov bx,[si+bp]
  mov dx,[bx]       ; dx = b.x
  mov ax,[bx+4]     ; ax = b.y
  mov bx,[si+bp+2]
  mov si,[bx]       ; si = c.x
  mov bx,[bx+4]     ; bx = c.y

; slopeLeft dest {dLpatch, dRpatch}, xL {!ax}, xR, dy {!ax, !dx}, x0 {!ax, !dx} {a.x, b.x}, y0 {!ax, !dx}
; Pushes initial x value onto stack
; Stomps ax, dx
%macro slopeLeft 6
%ifnidni %3,ax
  mov ax, %3
%endif
  sub ax, %2
  cmp %4, 0x100
  jae %%largeY
  mul %6
  div %4
  mov dx,0xffff
  push dx
  jmp %%done
%%largeY:
  xor dx, dx
  div %4
  push ax
  mul %6
%done:
  sub ax, %5
  neg ax
  mov [cs:%1-2], ax
%endmacro

; slopeRight dest {dLpatch, dRpatch}, dy {!ax, !dx}, x0 {!dx, !dx} {a.x, b.x}, y0 {!ax, !dx}
; ax = xR - xL
; Pushes initial x value onto stack
; Stomps ax, dx
%macro slopeRight 4
  cmp %2, 0x100
  jae %%largeY
  mul %4
  div %2
  mov dx,0xffff
  push dx
  jmp %%done
%%largeY:
  xor dx, dx
  div %2
  push ax
  mul %4
%done:
  add ax, %3
  mov [cs:%1-2], ax
%endmacro

; slope dest {dLpatch, dRpatch}, ux {!ax}, vx {!ax}, dy {!ax, !dx}, y0 {!ax, !dx}
; Pushes initial x value onto stack
; Stomps ax, dx
%macro slope 5
  mov ax, %3
  sub ax, %2
  jc %%left
  cmp %4, 0x100
  jae %%largeY
  mul %5
  div %4
  mov dx,0xffff
  push dx
  add ax, %3
  mov [cs:%1-2], ax
  jmp %%done
%%largeY:
  xor dx, dx
  div %4
  push ax
  mul %5
  add ax, %3
  mov [cs:%1-2], ax
  jmp %%done
%%left
  cmp %4, 0x100
  jae %%largeY
  mul %5
  div %4
  mov dx,0xffff
  push dx
  sub ax, %3
  neg ax
  mov [cs:%1-2], ax
  jmp %%done
%%largeY:
  xor dx, dx
  div %4
  push ax
  mul %5
  sub ax, %3
  neg ax
  mov [cs:%1-2], ax
%done:
%endmacro


  ; Fill triangle
  ; cx = a.x
  ; di = a.y
  ; dx = b.x
  ; ax = b.y
  ; si = c.x
  ; bx = c.y
  mov bp,colour+2
  cmp di,ax
  jle noSwapAB
  xchg di,ax
  xchg cx,dx
noSwapAB:
  cmp ax,bx
  jle noSwapBC
  xchg ax,bx
  xchg dx,si
noSwapBC:
  cmp di,ax
  jle noSwapAB2
  xchg di,ax
  xchg cx,dx
noSwapAB2:
  cmp di,ax
  jne notHorizontalAB
  cmp ax,bx
  je doneTriangle
  cmp cx,dx
  jbe noSwapABx
  xchg cx,dx
noSwapABx:
  mov [bp-coordBX],dx   ; b.x

  add ax,0xff
  mov [bp-yabInt],ah  ; yab = a.y.intCeiling();
  mov ax,bx
  inc ah
  mov [bp-yc],ah  ; yc = (c.y + 1).intFloor();

  xchg cx,bx       ; TODO: try switching definitions of bx and cx
  sub cx,di      ; yac = c.y - a.y

  sub di,[bp-yabFrac]
  neg di         ; yaa = yab - a.y

  slope dLpatch, si, bx, cx, di   ; c.x, a.x, yac, yaa
  mov bx,[bp-coordBX]
  slope dRpatch, si, bx, cx, di   ; c.x, b.x, yac, yaa
  pop ax
  pop dx
  mov si,[bp-colour]
  mov bx,[bp-yabInt]
  mov cx,[bp-yc]
  call fillTrapezoid
  jmp doneTriangle

notHorizontalAB:
;  mov [bp-coordAX],cx
  mov [bp-coordAY],di
  mov [bp-coordBX],dx
;  mov [bp-coordBY],ax
;  mov [bp-coordCX],si
  mov [bp-coordCY],bx

  xchg ax,di        ; ax = a.y, di = b.y
  inc ah
  mov [bp-yaInt],ah  ; ya = (a.y + 1).intFloor();

  mov ax,di         ; ax = b.y
  sub ax,[bp-coordAY]  ; a.y
  mov bx,ax     ; yab = b.y - a.y

  cmp di,bx
  jne notHorizontalBC
  cmp dx,si
  jbe noSwapBCx
  xchg dx,si
noSwapBCx:
  xchg ax,di    ; ax = b.y
  inc ah
  mov [bp-ybc],ah  ; ybc = (b.y + 1).intFloor();

  mov di,[bp-yaFrac]
  sub di,[bp-coordAY]  ; yaa = ya - a.y

  slope dRpatch, si, cx, bx, di   ; c.x, a.x, yab, yaa
  mov si,[bp-coordBX]
  slope dLpatch, si, cx, bx, di   ; b.x, a.x, yab, yaa
  pop ax
  pop dx
  mov si,[bp-colour]
  mov bx,[bp-yaInt]
  mov cx,[bp-ybc]
  call fillTrapezoid
  jmp doneTriangle

notHorizontalBC:
  mov [bp-coordCX],si

  mov ax,di   ; ax = b.y
  inc ah
  mov [bp-ybInt],ah  ; yb = (b.y + 1).intFloor();

  mov ax,[bp-coordCY]
  inc ah
  mov [bp-yc],ah  ; yc = (c.y + 1).intFloor();

  mov ax,[bp-yaFrac]
  sub ax,[bp-coordAY]
  mov [bp-yaa],ax

  mov ax,[bp-ybFrac]
  sub ax,[bp-coordBY]
  mov [bp-ybb],ax

  mov ax,[bp-coordCY]
  sub ax,[bp-coordAY]
  mov [bp-yac],ax

  mov ax,[bp-coordCY]
  sub ax,[bp-coordBY]
  mov [bp-ybc],ax

  mov ax,dx
  sub ax,cx  ; b.x - a.x
  jc abRight

  mov di,[bp-yab]
  mov bx,[bp-yaa]
  slopeRight xbPatch1, di, cx, bx ; yab, a.x, yaa

  mov ax,si
  sub ax,cx  ; c.x - a.x
  jc acRight

  mov di,[bp-yac]
  slopeRight xcPatch1, di, cx, bx ; yac, a.x, yaa

  pop ax
  pop bx
  mov cx,9999
xbPatch1:
  mov dx,9999
xcPatch1:
  cmp bx,ax                    ; wrong - we need to compare slopes here but the slope* macros push initialX
  jae dab_ge_dac
  mov [cs:dLpatch-2],cx
  mov [cs:dRpatch-2],dx

  mov si,[bp-colour]
  mov dx,bx
  mov bx,[bp-yaInt]
  mov cx,[bp-ybInt]
  push ax
  call fillTrapezoid

  mov si,[bp-coordCX]
  mov bx,[bp-coordBX]
  mov cx,[bp-ybc]
  mov di,[bp-ybb]
  slope dLpatch, si, bx, cx, di ; c.x, b.x, ybc, ybb
  pop dx

  mov si,[bp-colour]
  mov bx,[bp-ybInt]
  mov cx,[bp-yc]
  pop ax
  call fillTrapezoid
  jmp doneTriangle

dab_ge_dac:
  mov [cs:dLpatch-2],dx
  mov [cs:dRpatch-2],cx

  push ax
  mov dx,ax
  mov ax,bx
  mov si,[bp-colour]
  mov bx,[bp-yaInt]
  mov cx,[bp-ybInt]
  call fillTrapezoid

  mov si,[bp-coordCX]
  mov bx,[bp-coordBX]
  mov cx,[bp-ybc]
  mov di,[bp-ybb]
  slope dRpatch, si, bx, cx, di ; c.x, b.x, ybc, ybb
  pop ax

  pop dx
  mov si,[bp-colour]
  mov bx,[bp-ybInt]
  mov cx,[bp-yc]
  call fillTrapezoid
  jmp doneTriangle

acRight:
  slopeLeft d






doneTriangle:
  pop si
  pop bp
  pop cx
  inc bp
  inc bp
  loop drawFacePart


skipFace:
  pop ax
  pop cx
  loop faceLoop


  ; vsync
  mov dx,0x3da
vsync:
  in al,dx
  test al,8
  jz vsync


  ; Render deltas
  mov ax,0xb800
  mov es,ax
  xor di,di
  mov cx,100
  mov si,[spanBuffer]
  mov bp,spanBuffer1 + spanBuffer0
  sub bp,si
  mov bh,0
renderLoop:
  call renderDeltas
  add bp,spanBufferEntries*2
  add si,spanBufferEntries*2
  add di,0x2000
  call renderDeltas
  add bp,spanBufferEntries*2
  add si,spanBufferEntries*2
  add di,80-0x2000
  loop renderLoop


  ; Switch buffers
  mov ax,[spanBuffer]
  mov bx,spanBuffer1 + spanBuffer0
  sub bx,ax
  xchg ax,bx
  mov [spanBuffer],ax
  mov word[cs:spanBufferPatch+2],ax

  ; Clear next buffer
  mov di,ax
  call clearSpanBuffer

  ; Handle keyboard
  mov ah,1
  int 0x16
  test ax,ax
  jz noKey
  mov ah,0
  int 0x16

  cmp al,27
  jne noExit
  mov ax,3
  int 0x10
  mov ax,0x4c00
  int 0x21

noExit:
  cmp al,'n'
  je change
  cmp al,'N'
  jne noChange
  mov ax,[currentShape]
  add ax,6
  cmp ax,endShapes
  jne notEndShape
  mov ax,shapes
notEndShape:
  mov [currentShape],ax
noKey:
  jmp frameLoop

noChange:
  cmp al,' '
  jne noStartStop
  xor byte[autoRotate],1
  jmp noKey

noStartStop:
  cmp ah,0x4b
  jne noLeft
  test byte[autoRotate],1
  jz noLeftAccel
  dec word[dTheta]
  jmp noKey
noLeftAccel:
  dec word[theta]
  jmp noKey

noLeft:
  mov ah,0x4d
  jne noRight
  test byte[autoRotate],1
  jz noRightAccel
  inc word[dTheta]
  jmp noKey
noRightAccel:
  inc word[theta]
  jmp noKey

noRight:
  cmp ah,0x48
  jne noUp
  test byte[autoRotate],1
  jz noUpAccel
  dec word[dPhi]
  jmp noKey
noUpAccel:
  dec word[phi]
  jmp noKey

noDown:
  cmp ah,0x50
  jne noDown
  test byte[autoRotate],1
  jz noDownAccel
  inc word[dPhi]
  jmp noKey
noDownAccel:
  inc word[phi]
  jmp noKey


renderDeltas:
  ; inputs:
  ;   es:di = VRAM pointer
  ;   si = new spanbuffer
  ;   bp = old spanbuffer
  ;   bh = 0
  ; used:
  ;   al
  ;   ah = havePartial
  ;   bl
  ;   cl = xLn
  ;   ch
  ;   dl = xLo
  ;   dh = partial

  inc si
  inc si
  inc si       ; ++sn
  mov cl,0     ; xLn = 0
  inc bp
  inc bp
  inc bp       ; ++so
  mov dl,0     ; xLo = 0
  mov ah,0     ; havePartial = false
.loop:
  mov ch,[si]  ; xRn
  mov al,ch    ; xRn
  xor al,cl    ; xRn^xLn
  and al,0xfc  ; (xRn^xLn) & 0xfc
  jnz .notSameByte

  mov al,[si-1]  ; cn
  cmp al,[bp-1]  ; co
  jne .notSameColour
  test bl,bl
  jz .sameColour
.notSameColour:
  mov bl,cl      ; xLn
  and al,[bx+maskTable]  ; cn & mask[xLn]
  mov bl,ch      ; xRn
  and al,[bx+invMaskTable]  ; newBits = cn & mask[xLn] & ~mask[xRn]
  test ah,ah     ; havePartial
  jnz .gotPartial
  mov ah,1       ; havePartial = true
  test cl,3      ; xLn & 3
  jnz .unaligned
  mov dh,al      ; partial = newBits
  jmp .doneDelta
.unaligned:
  mov bl,cl      ; xLn
  mov dh,[bx+invMaskTAble]  ; ~mask[xLn]
  shr bx,1
  shr bx,1
  and dh,[es:di+bx] ; partial = vram[xLn >> 2] &~mask[xLn]
.gotPartial:
  or dh,al       ; partial |= newBits
  jmp .doneDelta
.sameColour:
  mov bl,[bp]  ; xRo
  mov dh,cl
  xor dh,bl    ; xRo^xLn
  and dh,0xfc  ; (xRo^xLn) & 0xfc
  jnz .doneDelta
  mov dh,[bx+maskTable]
  and al,dh    ; cn & mask[xRo]
  not dh
  mov bl,cl    ; xLn
  shr bx,1
  shr bx,1
  and dh,[es:di+bx]
  or dh,al     ; (vram[xLn >> 2] & ~mask[xRo]) | (cn & mask[xRo])
  mov bl,ch    ; xRn
  and dh,[bx+invMaskTable]
  mov ah,1     ; havePartial = true
  jmp .doneDelta
.notSameByte:
  mov al,[si-1]  ; cn
  cmp al,[bp-1]  ; co
  je .sameColour2
  mov bl,cl
  and al,[bx+maskTable]
  test ah,ah
  jnz .gotPartial2
  mov dh,[bx+invMaskTable]
  shr bx,1
  shr bx,1
  and dh,[es:di+bx]
.gotPartial2:
  or al,dh
  mov [es:di+bx],al
  jmp .doByteDelta
.sameColour2:
  test ah,ah
  jz .notGotPartial2
  mov bl,cl
  and al,[bx+maskTable]
  or al,dh
  shr bx,1
  shr bx,1
  mov [es:di+bx],al
  jmp .doByteDelta
.notGotPartial2:
  mov bl,[bp]  ; xRo
  xor bl,cl    ; xRo^xLn
  and bl,0xfc
  jnz .doByteDelta
  mov bl,cl
  and al,[bx+maskTable]
  mov dh,[bx+invMaskTable]
  mov bl,cl
  shr bx,1
  shr bx,1
  and dh,[es:di+bx]
  or al,dh
  mov [es:di+bx],al
.doByteDelta:
  add cl,3
  and cl,0xfc
  ; al = storeStart
  ; ch = storeEnd
  ; dh = store
  mov al,cl
  mov ch,cl
  mov dh,0
.doByteDeltaLoop:
  test dh,dh
  jz .noStore
  cmp al,[bp-1]
  jnz .byteLoopNext







; Span buffer format
;   word[bx]   = bx+n*2+1 (n = number of entries (not including final sentinel with x == 255))
;   byte[bx+2] = colour of pixel 0
;   byte[bx+3] = first transition position
;   ...
;   byte[bx+n*2+1] = 255

fillTrapezoid:
  ; inputs:
  ;   si = colour pair pointer
  ;   bx = yStart
  ;   cx = yEnd
  ;   dx = _xL
  ;   ax = _xR
  ; stomps: ax, bx, cx, dx, si, di
  push bp
  mov bp,bx
  and bp,1
  add si,bp
  sub cx,bx
  add bx,bx
  mov bx,[bx+spanBufferOffsets]
spanBufferPatch:
  add bx,9999
fillTrapezoidLoop:
  cmp dx,ax
  jge skipAddSpan
  push dx
  push ax
  push si
  lodsb
  push cx

  ; addSpan:
  ; inputs:
  ;   al = c
  ;   dh = xL
  ;   ah = xR
  ;   bx = span buffer line pointer + 1
  ; used:
  ;   di = &_s[i]._x = bx+2*i    di+1 = &_s[i]._c
  ;   si = &_s[j+1]._x = bx+2*j+2

  mov cx,[bx-1]

  mov di,bx
.findI:
  inc di
  inc di
  cmp dh,[di]
  jge .findI
  dec di
  dec di

  mov si,bx
.findJ:
  inc si
  inc si
  cmp dh,[si]
  jge .findJ

  cmp al,[di+1]
  jne .differentColourL
  mov dh,[di]
  jmp .doneCheckL
.differentColourL:
  cmp di,bx
  je .doneCheckL
  cmp dh,[di]
  jne .doneCheckL
  cmp al,[di-1]
  jne .doneCheckL
  dec di
  dec di
  mov dh,[di]
.doneCheckL:

  cmp al,[si-1]
  jne .differentColourR
  mov ah,[si]
  jmp .doneCheckR
.differentColourR:
  cmp si,cx
  jae .doneCheckR
  cmp ah,[si]
  jne .doneCheckR
  cmp al,[si+1]
  jne .doneCheckR
  inc si
  inc si
  mov ah,[si]
.doneCheckR:

  lea bp,[si-2]
  sub bp,di                 ; si-2-di = bx+2*j+2-2-bx-2*i = 2*(j-i)
  cmp dh,[di]
  jne .noLeftCoincide
  cmp ah,[si]
  jne .noRightCoincideL

  ; Both edges coincide with an existing edge
  sub cx,bp
  mov [bx-1],cx
  sub cx,di
  inc di
  stosb
  shr cx,1
  rep movsw
  jmp endAddSpan

.noRightCoincideL:
  ; Left edge coincides with an existing edge but right does not
  dec bp
  dec bp
  sub cx,bp
  mov [bx-1],cx
  cmp bp,0
  jl .oMinusOneL
  je .oZeroL
  sub cx,di       ; count = _n+1-i-2 = _n-i-1 = _n-(i+1)
  inc di
  stosw
  dec si          ; &_s[i+1+o]._c == &_s[i+1+j-i-1]._c = &_s[j]._c = si-1
  movsb
  shr cx,1        ; si = &_s[i+2+o] = &_s[i+2+j-i-1] = &_s[1+j]
  dec cx
  rep movsw
  jmp endAddSpan
.oZeroL:
  inc di
  stosw
  jmp endAddSpan
.oMinusOneL:
  xchg cx,di      ; cx = &_s[i], di = &_s[_n]
  lea si,[di+bp]  ; si = &_s[_n + o]
  neg cx
  add cx,si       ; cx = 2*(_n + o - i)
  shr cx,1
  std
  rep movsw       ; di = &_s[_n - _n - o + i] = &_s[i-o] = &_s[i+1]   (last word written was at [di+2])
  cld
  dec di
  stosw
  inc si
  movsb
  jmp endAddSpan

.noLeftCoincide:
  cmp ah,[di]
  jne .noRightCoincide

  ; Right edge coincides with an existing edge but left does not
  dec bp
  dec bp
  sub cx,bp
  mov [bx-1],cx
  cmp bp,0
  jl .oMinusOneR
  je .oZeroR
  inc di
  inc di
  sub cx,di       ; count = _n+1-i-2 = _n-i-1 = _n-(i+1)
  mov [di],dh
  inc di
  stosb
  shr cx,1        ; si = &_s[i+2+o] = &_s[i+2+j-i-1] = &_s[1+j]
  rep movsw
  jmp endAddSpan
.oZeroR:
  inc di
  inc di
  mov [di],dh
  inc di
  stosb
  jmp endAddSpan
.oMinusOneR:
  xchg cx,di      ; cx = &_s[i], di = &_s[_n]
  lea si,[di+bp]  ; si = &_s[_n + o]
  neg cx
  add cx,si       ; cx = 2*(_n + o - i)
  shr cx,1
  inc cx          ; cx = 1 + _n + o - i
  std
  rep movsw
  cld             ; di = &_s[_n - 1 - _n - o + i] = &_s[i-o-1] = &_s[i]   (last word written was at [di+2])
  inc di
  inc di
  mov [di],dh
  inc di
  stosb
  jmp endAddSpan

.noRightCoincide:
  ; Neither side coincides with an existing edge
  sub bp,4
  sub cx,bp
  mov [bx-1],cx
  cmp bp,0
  jl .oMinus
  je .oZero
  inc di
  inc di
  sub cx,di
  mov [di],dh     ; count = _n+1-i-3 = _n-i-2
  inc di
  stosw
  dec si
  movsb                     ; &_s[i+2+o]._c == &_s[i+2+j-i-2] == &_s[j]
  inc di    ; di = &_s[i+3]
  dec cx
  shr cx,1  ; si = &_s[i+3+o] = &_s[i+3+j-i-2] = &_s[j+1]
  rep movsw
  jmp endAddSpan
.oZero:
  mov [di+2],dh
  mov [di+3],ax
  jmp endAddSpan
.oMinus:
  cmp bp,-2
  jge .oMinusOne
  xchg cx,di      ; cx = &_s[i], di = &_s[_n]
  lea si,[di+bp]  ; si = &_s[_n + o] = &_s[_n - 2]
  neg cx
  add cx,si       ; cx = 2*(_n + o - i) = 2*(_n - 2 - i)
  shr cx,1
  std
  rep movsw       ; di = &_s[_n - _n - o + i] = &_s[i-o] = &_s[i+2]   (last word written was at [di+2] which is &_s[i+3])  si = &_s[i]
  movsw           ; di = &_s[i+1]
  cld
  mov [di],dh
  inc di
  stosw
  jmp endAddSpan
.oMinusOne:
  xchg cx,di      ; cx = &_s[i], di = &_s[_n]
  lea si,[di+bp]  ; si = &_s[_n + o]
  neg cx
  add cx,si       ; cx = 2*(_n + o - i)
  shr cx,1
  std
  rep movsw
  cld             ; di = &_s[_n - _n - o + i] = &_s[i-o] = &_s[i+2]   (last word written was at [di+2] which is &_s[i+3])  si = &_s[i]
  dec di
  mov [di-1],dh
  stosw
endAddSpan:

  pop cx
  pop si
  pop ax
  pop dx
skipAddSpan:
  xor si,1
  add dx,9999
dLpatch:
  add ax,9999
dRpatch:
  add bx,spanBufferEntries*2
  loop fillTrapezoidLoop
  pop bp
  ret



colours:
  db 0x00, 0x00
  db 0x55, 0x55
  db 0xaa, 0xaa
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  db 0x33, 0xcc

%macro vertex 1
  dw vertexBuffer+%1*4
%endmacro

%macro face 4-*
  dw 2*%1+colours,%0-2
  %rotate 1
  %rep %0-1
  vertex %1
  %endrep
%endmacro

%macro shape 4
  db %1
  dw %2
  db %3
  dw %4
%endmacro

vertexBuffer:
  times 20*3 dd 0

cubeVertices:
  dw -107, -107, -107
  dw -107, -107,  107
  dw -107,  107, -107
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  dw  107,  107,  107
cubeFaces:
  face 1,   0,  4,  6,  2
  face 2,   4,  5,  7,  6
  face 1,   5,  1,  3,  7
  face 2,   1,  0,  2,  3
  face 3,   2,  6,  7,  3
  face 3,   0,  1,  5,  4

octahedronVertices:
  dw  186,    0,    0
  dw -186,    0,    0
  dw    0,  186,    0
  dw    0, -186,    0
  dw    0,    0,  186
  dw    0,    0, -186
octahedronFaces:
  face 3,   4,  2,  0
  face 2,   5,  0,  2
  face 2,   4,  0,  3
  face 1,   5,  3,  0
  face 2,   4,  1,  2
  face 1,   5,  2,  1
  face 1,   4,  3,  1
  face 3,   5,  1,  3

tetrahedronVertices:
  dw  107,  107,  107
  dw  107, -107, -107
  dw -107,  107, -107
  dw -107, -107,  107
tetrahedronFaces:
  face 4,   1,  2,  3
  face 1,   0,  3,  2
  face 2,   3,  0,  1
  face 3,   2,  1,  0

icosahedronVertices:
  dw  158,   98,    0
  dw -158,   98,    0
  dw  158,  -98,    0
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  dw    0, -158,  -98
icosahedronFaces:
  face 1,   4,  8,  0
  face 2,  10,  5,  0
  face 2,   9,  4,  2
  face 3,   5, 11,  2
  face 2,   8,  6,  1
  face 6,   7, 10,  1
  face 5,   6,  9,  3
  face 2,  11,  7,  3
  face 3,   8, 10,  0
  face 5,  10,  8,  1
  face 1,  11,  9,  2
  face 6,   9, 11,  3
  face 5,   0,  2,  4
  face 6,   2,  0,  5
  face 1,   3,  1,  6
  face 3,   1,  3,  7
  face 6,   4,  6,  8
  face 3,   6,  4,  9
  face 1,   7,  5, 10
  face 5,   5,  7, 11

dodecahedronVertices:
  dw  107,  107,  107
  dw  107,  107, -107
  dw  107, -107,  107
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  dw    0,  -66, -174
dodecahedronFaces:
  face 1,  13, 12,  0,  8,  1
  face 1,  14, 15,  5,  9,  4
  face 4,  12, 13,  3, 10,  2
  face 2,  15, 14,  6, 11,  7
  face 2,  17, 16,  0, 12,  2
  face 2,  18, 19,  3, 13,  1
  face 4,  16, 17,  6, 14,  4
  face 3,  19, 18,  5, 15,  7
  face 3,   9,  8,  0, 16,  4
  face 3,  10, 11,  6, 17,  2
  face 4,   8,  9,  5, 18,  1
  face 1,  11, 10,  3, 19,  7

shapes:
  shape 8, cubeVertices, 6, cubeFaces
  shape 6, octahedronVertices, 8, octahedronFaces
  shape 4, tetrahedronVertices, 4, tetrahedronFaces
  shape 12, icosahedronVertices, 20, icosahedronFaces
  shape 20, dodecahedronVertices, 12, dodecahedronFaces
endShapes:

currentShape: dw shapes
spanBuffer: dw spanBuffer0
offsetX: dw 0
offsetY: dw 0
xx: dw 0
xy: dw 0
xz: dw 0
yx: dw 0
yy: dw 0
yz: dw 0
zy: dw 0
zz: dw 0
theta: dw 0
dTheta: dw 0
phi: dw 0
dPhi: dw 0
autoRotate: db 1

ybFrac equ 0x1d
ybInt equ 0x1c
ybc equ 0x1a
yaFrac equ 0x18
yaInt equ 0x17
coordAX equ 0x15
coordAY equ 0x13
coordBX equ 0x11
coordBY equ 0xf
coordCX equ 0xd
coordCY equ 0xb
yabFrac equ 9
yabInt equ 8
yc equ 6
yac equ 4
colour equ 2

  db 0
yc: dw 0       ; bp-0x1f
  db 0
yb: dw 0       ; bp-0x1c
ybc: dw 0      ; bp-0x1a
  db 0
ya: dw 0       ; bp-0x17
coordAX: dw 0  ; bp-0x15
coordAY: dw 0  ; bp-0x13
coordBX: dw 0  ; bp-0x11
coordBY: dw 0  ; bp-0xf
coordCX: dw 0  ; bp-0xd
coordCY: dw 0  ; bp-0xb
  db 0
yab: dw 0      ; bp-8
yc: dw 0       ; bp-6
yac: dw 0      ; bp-4
colour: dw 0   ; bp-2

spanBufferEntries equ 20
lines equ 200
spanBufferSize equ spanBufferEntries*lines*2

spanBuffer0:
  times spanBufferSize db 0
spanBuffer1:
  times spanBufferSize db 0
spanBufferEnd:

spanBuffersOffsets:
  %assign i 0
  %rotate 1
  %rep 100
  dw i
  %assign i i+spanBufferEntries*2
  %endrep



clearSpanBuffer:
  mov cx,lines
  mov bx,spanBufferEntries*2
  add di,2
  mov ax,0xff00
.loop:
  mov word[di-2],di
  mov word[di],ax
  add di,bx
  loop .loop
  ret

sine:
  dw 0x0000, 0x0000, 0x0001, 0x0002, 0x0003, 0x0003, 0x0004, 0x0005
  dw 0x0006, 0x0007, 0x0007, 0x0008, 0x0009, 0x000a, 0x000a, 0x000b
  dw 0x000c, 0x000d, 0x000e, 0x000e, 0x000f, 0x0010, 0x0011, 0x0012
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  dw 0x00ff, 0x00ff, 0x00ff, 0x00ff, 0x00ff, 0x00ff, 0x00ff, 0x00ff
cosine:
  dw 0x0100, 0x00ff, 0x00ff, 0x00ff, 0x00ff, 0x00ff, 0x00ff, 0x00ff
  dw 0x00ff, 0x00ff, 0x00ff, 0x00ff, 0x00ff, 0x00ff, 0x00ff, 0x00ff
  dw 0x00ff, 0x00ff, 0x00ff, 0x00ff, 0x00ff, 0x00ff, 0x00ff, 0x00ff
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  dw 0x00ff, 0x00ff, 0x00ff, 0x00ff, 0x00ff, 0x00ff, 0x00ff, 0x00ff


;0000 1111 2222 3333
;0101 0202 0303 1212 1313 2323
;0001 0111 0002 0222 0003 0333 1112 1222 1113 1333 2223 2333
;0012 0013 0023 1123 0112 0113 0223 1223 0122 0133 0233 1233
;0123


