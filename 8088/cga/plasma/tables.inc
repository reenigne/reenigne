%macro updateRoutine 0
  movsb
  inc di
  movsb
  inc di
  movsb
  add di,22
  movsb
  inc di
  movsb
  inc di
  movsb
  inc di
  movsb
  inc di
  movsb
  inc di
  movsb
  inc di
  movsb
  add di,114
  movsb
  inc di
  movsb
  inc di
  movsb
  inc di
  movsb
  inc di
  movsb
  inc di
  movsb
  inc di
  movsb
  inc di
  movsb
  add di,14
  movsb
  inc di
  movsb
  inc di
  movsb
  inc di
  movsb
  inc di
  movsb
  inc di
  movsb
  inc di
  movsb
  inc di
  movsb
  inc di
  movsb
  inc di
  movsb
  add di,108
  movsb
  inc di
  movsb
  inc di
  movsb
  inc di
  movsb
  inc di
  movsb
  inc di
  movsb
  inc di
  movsb
  inc di
  movsb
  inc di
  movsb
  inc di
  movsb
  add di,10
  movsb
  inc di
  movsb
  inc di
  movsb
  inc di
  movsb
  inc di
  movsb
  inc di
  movsb
  inc di
  movsb
  inc di
  movsb
  inc di
  movsb
  inc di
  movsb
  inc di
  movsb
  inc di
  movsb
  inc di
  movsb
  add di,104
  movsb
  inc di
  movsb
  inc di
  movsb
  inc di
  movsb
  inc di
  movsb
  inc di
  movsb
  inc di
  movsb
  inc di
  movsb
  inc di
  movsb
  inc di
  movsb
  add di,8
  movsb
  inc di
  movsb
  inc di
  movsb
  inc di
  movsb
  inc di
  movsb
  inc di
  movsb
  inc di
  movsb
  inc di
  movsb
  inc di
  movsb
  inc di
  movsb
  inc di
  movsb
  inc di
  movsb
  inc di
  movsb
  inc di
  movsb
  add di,102
  movsb
  inc di
  movsb
  inc di
  movsb
  inc di
  movsb
  inc di
  movsb
  inc di
  movsb
  inc di
  movsb
  inc di
  movsb
  inc di
  movsb
  inc di
  movsb
  inc di
  movsb
  inc di
  movsb
  add di,6
  movsb
  inc di
  movsb
  inc di
  movsb
  inc di
  movsb
  inc di
  movsb
  inc di
  movsb
  inc di
  movsb
  inc di
  movsb
  inc di
  movsb
  inc di
  movsb
  inc di
  movsb
  inc di
  movsb
  inc di
  movsb
  inc di
  movsb
  inc di
  movsb
  add di,100
  movsb
  inc di
  movsb
  inc di
  movsb
  inc di
  movsb
  inc di
  movsb
  inc di
  movsb
  inc di
  movsb
  inc di
  movsb
  inc di
  movsb
  inc di
  movsb
  inc di
  movsb
  inc di
  movsb
  add di,6
  movsb
  inc di
  movsb
  inc di
  movsb
  inc di
  movsb
  inc di
  movsb
  inc di
  movsb
  inc di
  movsb
  inc di
  movsb
  inc di
  movsb
  inc di
  movsb
  inc di
  movsb
  inc di
  movsb
  inc di
  movsb
  inc di
  movsb
  inc di
  movsb
  add di,100
  movsb
  inc di
  movsb
  inc di
  movsb
  inc di
  movsb
  inc di
  movsb
  inc di
  movsb
  inc di
  movsb
  inc di
  movsb
  inc di
  movsb
  inc di
  movsb
  inc di
  movsb
  inc di
  movsb
  add di,6
  movsb
  inc di
  movsb
  inc di
  movsb
  inc di
  movsb
  inc di
  movsb
  inc di
  movsb
  inc di
  movsb
  inc di
  movsb
  inc di
  movsb
  inc di
  movsb
  inc di
  movsb
  inc di
  movsb
  inc di
  movsb
  inc di
  movsb
  inc di
  movsb
  add di,100
  movsb
  inc di
  movsb
  inc di
  movsb
  inc di
  movsb
  inc di
  movsb
  inc di
  movsb
  inc di
  movsb
  inc di
  movsb
  inc di
  movsb
  inc di
  movsb
  inc di
  movsb
  inc di
  movsb
  add di,6
  movsb
  inc di
  movsb
  inc di
  movsb
  inc di
  movsb
  inc di
  movsb
  inc di
  movsb
  inc di
  movsb
  inc di
  movsb
  inc di
  movsb
  inc di
  movsb
  inc di
  movsb
  inc di
  movsb
  inc di
  movsb
  inc di
  movsb
  inc di
  movsb
  inc di
  movsb
  add di,98
  movsb
  inc di
  movsb
  inc di
  movsb
  inc di
  movsb
  inc di
  movsb
  inc di
  movsb
  inc di
  movsb
  inc di
  movsb
  inc di
  movsb
  inc di
  movsb
  inc di
  movsb
  inc di
  movsb
  add di,8
  movsb
  inc di
  movsb
  inc di
  movsb
  inc di
  movsb
  inc di
  movsb
  inc di
  movsb
  inc di
  movsb
  inc di
  movsb
  inc di
  movsb
  inc di
  movsb
  inc di
  movsb
  inc di
  movsb
  inc di
  movsb
  inc di
  movsb
  inc di
  movsb
  add di,98
  movsb
  inc di
  movsb
  inc di
  movsb
  inc di
  movsb
  inc di
  movsb
  inc di
  movsb
  inc di
  movsb
  inc di
  movsb
  inc di
  movsb
  inc di
  movsb
  inc di
  movsb
  add di,10
  movsb
  inc di
  movsb
  inc di
  movsb
  inc di
  movsb
  inc di
  movsb
  inc di
  movsb
  inc di
  movsb
  inc di
  movsb
  inc di
  movsb
  inc di
  movsb
  inc di
  movsb
  inc di
  movsb
  inc di
  movsb
  inc di
  movsb
  inc di
  movsb
  add di,98
  movsb
  inc di
  movsb
  inc di
  movsb
  inc di
  movsb
  inc di
  movsb
  inc di
  movsb
  inc di
  movsb
  inc di
  movsb
  inc di
  movsb
  inc di
  movsb
  inc di
  movsb
  add di,10
  movsb
  inc di
  movsb
  inc di
  movsb
  inc di
  movsb
  inc di
  movsb
  inc di
  movsb
  inc di
  movsb
  inc di
  movsb
  inc di
  movsb
  inc di
  movsb
  inc di
  movsb
  inc di
  movsb
  inc di
  movsb
  inc di
  movsb
  inc di
  movsb
  add di,98
  movsb
  inc di
  movsb
  inc di
  movsb
  inc di
  movsb
  inc di
  movsb
  inc di
  movsb
  inc di
  movsb
  inc di
  movsb
  inc di
  movsb
  inc di
  movsb
  inc di
  movsb
  add di,12
  movsb
  inc di
  movsb
  inc di
  movsb
  inc di
  movsb
  inc di
  movsb
  inc di
  movsb
  inc di
  movsb
  inc di
  movsb
  inc di
  movsb
  inc di
  movsb
  inc di
  movsb
  inc di
  movsb
  inc di
  movsb
  inc di
  movsb
  add di,98
  movsb
  inc di
  movsb
  inc di
  movsb
  inc di
  movsb
  inc di
  movsb
  inc di
  movsb
  inc di
  movsb
  inc di
  movsb
  inc di
  movsb
  inc di
  movsb
  add di,14
  movsb
  inc di
  movsb
  inc di
  movsb
  inc di
  movsb
  inc di
  movsb
  inc di
  movsb
  inc di
  movsb
  inc di
  movsb
  inc di
  movsb
  inc di
  movsb
  inc di
  movsb
  inc di
  movsb
  inc di
  movsb
  inc di
  movsb
  add di,98
  movsb
  inc di
  movsb
  inc di
  movsb
  inc di
  movsb
  inc di
  movsb
  inc di
  movsb
  inc di
  movsb
  inc di
  movsb
  inc di
  movsb
  inc di
  movsb
  add di,14
  movsb
  inc di
  movsb
  inc di
  movsb
  inc di
  movsb
  inc di
  movsb
  inc di
  movsb
  inc di
  movsb
  inc di
  movsb
  inc di
  movsb
  inc di
  movsb
  inc di
  movsb
  inc di
  movsb
  inc di
  movsb
  inc di
  movsb
  add di,100
  movsb
  inc di
  movsb
  inc di
  movsb
  inc di
  movsb
  inc di
  movsb
  inc di
  movsb
  inc di
  movsb
  inc di
  movsb
  inc di
  movsb
  add di,16
  movsb
  inc di
  movsb
  inc di
  movsb
  inc di
  movsb
  inc di
  movsb
  inc di
  movsb
  inc di
  movsb
  inc di
  movsb
  inc di
  movsb
  inc di
  movsb
  inc di
  movsb
  inc di
  movsb
  inc di
  movsb
  add di,100
  movsb
  inc di
  movsb
  inc di
  movsb
  inc di
  movsb
  inc di
  movsb
  inc di
  movsb
  inc di
  movsb
  inc di
  movsb
  add di,18
  movsb
  inc di
  movsb
  inc di
  movsb
  inc di
  movsb
  inc di
  movsb
  inc di
  movsb
  inc di
  movsb
  inc di
  movsb
  inc di
  movsb
  inc di
  movsb
  inc di
  movsb
  inc di
  movsb
  inc di
  movsb
  add di,100
  movsb
  inc di
  movsb
  inc di
  movsb
  inc di
  movsb
  inc di
  movsb
  inc di
  movsb
  inc di
  movsb
  inc di
  movsb
  add di,20
  movsb
  inc di
  movsb
  inc di
  movsb
  inc di
  movsb
  inc di
  movsb
  inc di
  movsb
  inc di
  movsb
  inc di
  movsb
  inc di
  movsb
  inc di
  movsb
  inc di
  movsb
  add di,104
  movsb
  inc di
  movsb
  inc di
  movsb
  inc di
  movsb
  inc di
  movsb
  inc di
  movsb
  add di,24
  movsb
  inc di
  movsb
  inc di
  movsb
  inc di
  movsb
  inc di
  movsb
  inc di
  movsb
  inc di
  movsb
  inc di
  movsb
  inc di
  movsb
  inc di
  movsb
  add di,104
  movsb
  inc di
  movsb
  inc di
  movsb
  inc di
  movsb
  inc di
  movsb
  inc di
  movsb
  add di,26
  movsb
  inc di
  movsb
  inc di
  movsb
  inc di
  movsb
  inc di
  movsb
  inc di
  movsb
  inc di
  movsb
  inc di
  movsb
  add di,108
  movsb
  inc di
  movsb
  inc di
  movsb
  inc di
  movsb
  add di,30
  movsb
  inc di
  movsb
  inc di
  movsb
  inc di
  movsb
  inc di
  movsb
  inc di
  movsb
  inc di
  movsb
  add di,110
  movsb
  inc di
  movsb
  add di,34
  movsb
  inc di
  movsb
  inc di
  movsb
  inc di
  movsb
  inc di
  movsb
%endmacro
%macro plasmaRoutine 0
  plasmaIteration 1,0
  plasmaIteration 1,1
  plasmaIteration 1,1
  plasmaIteration 1,12
  plasmaIteration 1,1
  plasmaIteration 1,1
  plasmaIteration 1,1
  plasmaIteration 1,1
  plasmaIteration 1,1
  plasmaIteration 1,1
  plasmaIncrementY
  plasmaIteration 1,-22
  plasmaIteration 1,1
  plasmaIteration 0,1
  plasmaIteration 0,1
  plasmaIteration 0,1
  plasmaIteration 1,1
  plasmaIteration 1,1
  plasmaIteration 1,1
  plasmaIteration 1,8
  plasmaIteration 0,1
  plasmaIteration 0,1
  plasmaIteration 0,1
  plasmaIteration 0,1
  plasmaIteration 0,1
  plasmaIteration 0,1
  plasmaIteration 0,1
  plasmaIteration 1,1
  plasmaIteration 1,1
  plasmaIncrementY
  plasmaIteration 1,-25
  plasmaIteration 0,1
  plasmaIteration 0,1
  plasmaIteration 0,1
  plasmaIteration 0,1
  plasmaIteration 0,1
  plasmaIteration 0,1
  plasmaIteration 0,1
  plasmaIteration 0,1
  plasmaIteration 1,1
  plasmaIteration 1,6
  plasmaIteration 0,1
  plasmaIteration 0,1
  plasmaIteration 0,1
  plasmaIteration 0,1
  plasmaIteration 0,1
  plasmaIteration 0,1
  plasmaIteration 0,1
  plasmaIteration 0,1
  plasmaIteration 0,1
  plasmaIteration 0,1
  plasmaIteration 1,1
  plasmaIteration 1,1
  plasmaIncrementY
  plasmaIteration 1,-27
  plasmaIteration 0,1
  plasmaIteration 0,1
  plasmaIteration 0,1
  plasmaIteration 0,1
  plasmaIteration 0,1
  plasmaIteration 0,1
  plasmaIteration 0,1
  plasmaIteration 0,1
  plasmaIteration 1,1
  plasmaIteration 1,5
  plasmaIteration 0,1
  plasmaIteration 0,1
  plasmaIteration 0,1
  plasmaIteration 0,1
  plasmaIteration 0,1
  plasmaIteration 0,1
  plasmaIteration 0,1
  plasmaIteration 0,1
  plasmaIteration 0,1
  plasmaIteration 0,1
  plasmaIteration 0,1
  plasmaIteration 0,1
  plasmaIteration 1,1
  plasmaIncrementY
  plasmaIteration 1,-28
  plasmaIteration 0,1
  plasmaIteration 0,1
  plasmaIteration 0,1
  plasmaIteration 0,1
  plasmaIteration 0,1
  plasmaIteration 0,1
  plasmaIteration 0,1
  plasmaIteration 0,1
  plasmaIteration 0,1
  plasmaIteration 0,1
  plasmaIteration 1,1
  plasmaIteration 1,4
  plasmaIteration 0,1
  plasmaIteration 0,1
  plasmaIteration 0,1
  plasmaIteration 0,1
  plasmaIteration 0,1
  plasmaIteration 0,1
  plasmaIteration 0,1
  plasmaIteration 0,1
  plasmaIteration 0,1
  plasmaIteration 0,1
  plasmaIteration 0,1
  plasmaIteration 0,1
  plasmaIteration 0,1
  plasmaIteration 1,1
  plasmaIncrementY
  plasmaIteration 1,-29
  plasmaIteration 0,1
  plasmaIteration 0,1
  plasmaIteration 0,1
  plasmaIteration 0,1
  plasmaIteration 0,1
  plasmaIteration 0,1
  plasmaIteration 0,1
  plasmaIteration 0,1
  plasmaIteration 0,1
  plasmaIteration 0,1
  plasmaIteration 1,1
  plasmaIteration 1,4
  plasmaIteration 0,1
  plasmaIteration 0,1
  plasmaIteration 0,1
  plasmaIteration 0,1
  plasmaIteration 0,1
  plasmaIteration 0,1
  plasmaIteration 0,1
  plasmaIteration 0,1
  plasmaIteration 0,1
  plasmaIteration 0,1
  plasmaIteration 0,1
  plasmaIteration 0,1
  plasmaIteration 0,1
  plasmaIteration 1,1
  plasmaIncrementY
  plasmaIteration 1,-29
  plasmaIteration 0,1
  plasmaIteration 0,1
  plasmaIteration 0,1
  plasmaIteration 0,1
  plasmaIteration 0,1
  plasmaIteration 0,1
  plasmaIteration 0,1
  plasmaIteration 0,1
  plasmaIteration 0,1
  plasmaIteration 0,1
  plasmaIteration 1,1
  plasmaIteration 1,4
  plasmaIteration 0,1
  plasmaIteration 0,1
  plasmaIteration 0,1
  plasmaIteration 0,1
  plasmaIteration 0,1
  plasmaIteration 0,1
  plasmaIteration 0,1
  plasmaIteration 0,1
  plasmaIteration 0,1
  plasmaIteration 0,1
  plasmaIteration 0,1
  plasmaIteration 0,1
  plasmaIteration 0,1
  plasmaIteration 1,1
  plasmaIncrementY
  plasmaIteration 1,-29
  plasmaIteration 0,1
  plasmaIteration 0,1
  plasmaIteration 0,1
  plasmaIteration 0,1
  plasmaIteration 0,1
  plasmaIteration 0,1
  plasmaIteration 0,1
  plasmaIteration 0,1
  plasmaIteration 0,1
  plasmaIteration 0,1
  plasmaIteration 1,1
  plasmaIteration 1,4
  plasmaIteration 0,1
  plasmaIteration 0,1
  plasmaIteration 0,1
  plasmaIteration 0,1
  plasmaIteration 0,1
  plasmaIteration 0,1
  plasmaIteration 0,1
  plasmaIteration 0,1
  plasmaIteration 0,1
  plasmaIteration 0,1
  plasmaIteration 0,1
  plasmaIteration 0,1
  plasmaIteration 0,1
  plasmaIteration 0,1
  plasmaIteration 1,1
  plasmaIncrementY
  plasmaIteration 1,-30
  plasmaIteration 0,1
  plasmaIteration 0,1
  plasmaIteration 0,1
  plasmaIteration 0,1
  plasmaIteration 0,1
  plasmaIteration 0,1
  plasmaIteration 0,1
  plasmaIteration 0,1
  plasmaIteration 0,1
  plasmaIteration 0,1
  plasmaIteration 1,1
  plasmaIteration 1,5
  plasmaIteration 0,1
  plasmaIteration 0,1
  plasmaIteration 0,1
  plasmaIteration 0,1
  plasmaIteration 0,1
  plasmaIteration 0,1
  plasmaIteration 0,1
  plasmaIteration 0,1
  plasmaIteration 0,1
  plasmaIteration 0,1
  plasmaIteration 0,1
  plasmaIteration 0,1
  plasmaIteration 0,1
  plasmaIteration 1,1
  plasmaIncrementY
  plasmaIteration 1,-30
  plasmaIteration 0,1
  plasmaIteration 0,1
  plasmaIteration 0,1
  plasmaIteration 0,1
  plasmaIteration 0,1
  plasmaIteration 0,1
  plasmaIteration 0,1
  plasmaIteration 0,1
  plasmaIteration 0,1
  plasmaIteration 1,1
  plasmaIteration 1,6
  plasmaIteration 0,1
  plasmaIteration 0,1
  plasmaIteration 0,1
  plasmaIteration 0,1
  plasmaIteration 0,1
  plasmaIteration 0,1
  plasmaIteration 0,1
  plasmaIteration 0,1
  plasmaIteration 0,1
  plasmaIteration 0,1
  plasmaIteration 0,1
  plasmaIteration 0,1
  plasmaIteration 0,1
  plasmaIteration 1,1
  plasmaIncrementY
  plasmaIteration 1,-30
  plasmaIteration 0,1
  plasmaIteration 0,1
  plasmaIteration 0,1
  plasmaIteration 0,1
  plasmaIteration 0,1
  plasmaIteration 0,1
  plasmaIteration 0,1
  plasmaIteration 0,1
  plasmaIteration 0,1
  plasmaIteration 1,1
  plasmaIteration 1,6
  plasmaIteration 0,1
  plasmaIteration 0,1
  plasmaIteration 0,1
  plasmaIteration 0,1
  plasmaIteration 0,1
  plasmaIteration 0,1
  plasmaIteration 0,1
  plasmaIteration 0,1
  plasmaIteration 0,1
  plasmaIteration 0,1
  plasmaIteration 0,1
  plasmaIteration 0,1
  plasmaIteration 0,1
  plasmaIteration 1,1
  plasmaIncrementY
  plasmaIteration 1,-30
  plasmaIteration 0,1
  plasmaIteration 0,1
  plasmaIteration 0,1
  plasmaIteration 0,1
  plasmaIteration 0,1
  plasmaIteration 0,1
  plasmaIteration 0,1
  plasmaIteration 0,1
  plasmaIteration 0,1
  plasmaIteration 1,1
  plasmaIteration 1,7
  plasmaIteration 0,1
  plasmaIteration 0,1
  plasmaIteration 0,1
  plasmaIteration 0,1
  plasmaIteration 0,1
  plasmaIteration 0,1
  plasmaIteration 0,1
  plasmaIteration 0,1
  plasmaIteration 0,1
  plasmaIteration 0,1
  plasmaIteration 0,1
  plasmaIteration 0,1
  plasmaIteration 1,1
  plasmaIncrementY
  plasmaIteration 1,-30
  plasmaIteration 0,1
  plasmaIteration 0,1
  plasmaIteration 0,1
  plasmaIteration 0,1
  plasmaIteration 0,1
  plasmaIteration 0,1
  plasmaIteration 0,1
  plasmaIteration 0,1
  plasmaIteration 1,1
  plasmaIteration 1,8
  plasmaIteration 0,1
  plasmaIteration 0,1
  plasmaIteration 0,1
  plasmaIteration 0,1
  plasmaIteration 0,1
  plasmaIteration 0,1
  plasmaIteration 0,1
  plasmaIteration 0,1
  plasmaIteration 0,1
  plasmaIteration 0,1
  plasmaIteration 0,1
  plasmaIteration 0,1
  plasmaIteration 1,1
  plasmaIncrementY
  plasmaIteration 1,-30
  plasmaIteration 0,1
  plasmaIteration 0,1
  plasmaIteration 0,1
  plasmaIteration 0,1
  plasmaIteration 0,1
  plasmaIteration 0,1
  plasmaIteration 0,1
  plasmaIteration 0,1
  plasmaIteration 1,1
  plasmaIteration 1,8
  plasmaIteration 0,1
  plasmaIteration 0,1
  plasmaIteration 0,1
  plasmaIteration 0,1
  plasmaIteration 0,1
  plasmaIteration 0,1
  plasmaIteration 0,1
  plasmaIteration 0,1
  plasmaIteration 0,1
  plasmaIteration 0,1
  plasmaIteration 0,1
  plasmaIteration 0,1
  plasmaIteration 1,1
  plasmaIncrementY
  plasmaIteration 1,-29
  plasmaIteration 0,1
  plasmaIteration 0,1
  plasmaIteration 0,1
  plasmaIteration 0,1
  plasmaIteration 0,1
  plasmaIteration 0,1
  plasmaIteration 0,1
  plasmaIteration 1,1
  plasmaIteration 1,9
  plasmaIteration 0,1
  plasmaIteration 0,1
  plasmaIteration 0,1
  plasmaIteration 0,1
  plasmaIteration 0,1
  plasmaIteration 0,1
  plasmaIteration 0,1
  plasmaIteration 0,1
  plasmaIteration 0,1
  plasmaIteration 0,1
  plasmaIteration 0,1
  plasmaIteration 1,1
  plasmaIncrementY
  plasmaIteration 1,-29
  plasmaIteration 0,1
  plasmaIteration 0,1
  plasmaIteration 0,1
  plasmaIteration 0,1
  plasmaIteration 0,1
  plasmaIteration 0,1
  plasmaIteration 1,1
  plasmaIteration 1,10
  plasmaIteration 0,1
  plasmaIteration 0,1
  plasmaIteration 0,1
  plasmaIteration 0,1
  plasmaIteration 0,1
  plasmaIteration 0,1
  plasmaIteration 0,1
  plasmaIteration 0,1
  plasmaIteration 0,1
  plasmaIteration 0,1
  plasmaIteration 0,1
  plasmaIteration 1,1
  plasmaIncrementY
  plasmaIteration 1,-29
  plasmaIteration 0,1
  plasmaIteration 0,1
  plasmaIteration 0,1
  plasmaIteration 0,1
  plasmaIteration 0,1
  plasmaIteration 0,1
  plasmaIteration 1,1
  plasmaIteration 1,11
  plasmaIteration 0,1
  plasmaIteration 0,1
  plasmaIteration 0,1
  plasmaIteration 0,1
  plasmaIteration 0,1
  plasmaIteration 0,1
  plasmaIteration 0,1
  plasmaIteration 0,1
  plasmaIteration 0,1
  plasmaIteration 1,1
  plasmaIncrementY
  plasmaIteration 1,-27
  plasmaIteration 0,1
  plasmaIteration 0,1
  plasmaIteration 0,1
  plasmaIteration 0,1
  plasmaIteration 1,1
  plasmaIteration 1,13
  plasmaIteration 0,1
  plasmaIteration 0,1
  plasmaIteration 0,1
  plasmaIteration 0,1
  plasmaIteration 0,1
  plasmaIteration 0,1
  plasmaIteration 0,1
  plasmaIteration 0,1
  plasmaIteration 1,1
  plasmaIncrementY
  plasmaIteration 1,-27
  plasmaIteration 0,1
  plasmaIteration 0,1
  plasmaIteration 0,1
  plasmaIteration 0,1
  plasmaIteration 1,1
  plasmaIteration 1,14
  plasmaIteration 0,1
  plasmaIteration 0,1
  plasmaIteration 0,1
  plasmaIteration 0,1
  plasmaIteration 0,1
  plasmaIteration 0,1
  plasmaIteration 1,1
  plasmaIncrementY
  plasmaIteration 1,-25
  plasmaIteration 0,1
  plasmaIteration 0,1
  plasmaIteration 1,1
  plasmaIteration 1,16
  plasmaIteration 0,1
  plasmaIteration 0,1
  plasmaIteration 0,1
  plasmaIteration 0,1
  plasmaIteration 0,1
  plasmaIteration 1,1
  plasmaIncrementY
  plasmaIteration 1,-24
  plasmaIteration 1,1
  plasmaIteration 1,18
  plasmaIteration 1,1
  plasmaIteration 1,1
  plasmaIteration 1,1
  plasmaIteration 1,1
%endmacro
%endmacro
%macro dataTables 0
image:
  dw 0x268E, 0x62B1, 0x628E, 0x2614, 0x622B, 0x651D, 0x65B0, 0x658E, 0x56B1, 0x65DD, 0x6514, 0xCE8E, 0xEC14, 0xCE1D, 0xCE2B, 0xC61D
  dw 0xC6B0, 0xC68E, 0x6CDE, 0x6C8E, 0xC614, 0x6C05, 0x651D, 0x398E, 0x9314, 0x3811, 0x8820, 0x8820, 0x8820, 0x807B, 0x807B, 0x807B
  dw 0x80FB, 0x087E, 0x087B, 0x805A, 0x80E8, 0x8820, 0x801A, 0x8820, 0x8820, 0x8820, 0x8820, 0x8820, 0x8820, 0x8820, 0x8085, 0x8820
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  dw 0x0120, 0xBEB0, 0xBE8E, 0xEBB1, 0xEB2B, 0xBE14, 0xEB1D, 0xEC1D, 0xEC01, 0xEC8E, 0xCEE8, 0xCE8E, 0x4501, 0x54B0, 0x548E, 0x54B1
sinTable:
  dw 0, 12, 25, 37, 50, 62, 75, 87, 100, 112, 125, 137, 150, 162, 175, 187
  dw 199, 212, 224, 236, 248, 260, 273, 285, 297, 309, 321, 333, 344, 356, 368, 380
  dw 391, 403, 414, 426, 437, 449, 460, 471, 482, 493, 504, 515, 526, 537, 547, 558
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  dw -199, -187, -175, -162, -150, -137, -125, -112, -100, -87, -75, -62, -50, -37, -25, -12
%endmacro
initlalUpdateOffset equ 6125
