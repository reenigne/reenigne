denominator equ 2290
fadeSteps equ 9
spaceStartInitial equ 279
spaceStartFracInitial equ 1090
spaceEndInitial equ 314
spaceEndFracInitial equ 940
spaceStepIncrement equ -314
spaceStepFracIncrement equ -940
frameIncrement equ 34
frameFracIncrement equ 2140
maximumIterations equ 36
totalFrames equ 319
imageCount equ 6
fadeType equ 1
%macro dataTables 0
wipeSequence:
  dw 0x04B6, 0x04BE, 0x0418, 0x06A0, 0x069A, 0x041C, 0x0600, 0x045E, 0x0736, 0x0696, 0x04FE, 0x05F8, 0x05FA, 0x04B8, 0x037C, 0x0738
  dw 0x05FC, 0x073A, 0x055A, 0x04BC, 0x0698, 0x05F6, 0x0556, 0x041A, 0x05FE, 0x055E, 0x055C, 0x0558, 0x04BA, 0x069C, 0x037A, 0x069E
  dw 0x07DC, 0x0500, 0x07D8, 0x063E, 0x06DE, 0x07DE, 0x03BE, 0x063C, 0x0322, 0x059E, 0x041E, 0x0320, 0x02DC, 0x03C2, 0x073E, 0x0740
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  dw 0x349C, 0x3040, 0x353C, 0x317C, 0x32BC, 0x317E, 0x2F9E, 0x349A, 0x2FA0, 0x30DE, 0x335E, 0x2F9C, 0x30E0, 0x335C, 0x3180, 0x321C

align 256,db 0
rgbCube:
  dw 0x0014, 0x018E, 0x10B0, 0x1114, 0x1114, 0x197F, 0x197F, 0x191D
  dw 0x028E, 0x038E, 0x128E, 0x138E, 0x1B1D, 0x1B1D, 0xB114, 0x93B0
  dw 0x20B0, 0x21B0, 0x30B0, 0x31B0, 0x31B0, 0x39B0, 0x398E, 0x398E
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  dw 0x2AB0, 0xA3B0, 0x3AB1, 0x2BB1, 0xB28E, 0xB38E, 0xB3B0, 0x3B14
redTable0:
    db ((rgbCube - redGreenImages) >> 8) + 0x00, ((rgbCube - redGreenImages) >> 8) + 0x00, ((rgbCube - redGreenImages) >> 8) + 0x00, ((rgbCube - redGreenImages) >> 8) + 0x00, ((rgbCube - redGreenImages) >> 8) + 0x00, ((rgbCube - redGreenImages) >> 8) + 0x00, ((rgbCube - redGreenImages) >> 8) + 0x00, ((rgbCube - redGreenImages) >> 8) + 0x00
    db ((rgbCube - redGreenImages) >> 8) + 0x01, ((rgbCube - redGreenImages) >> 8) + 0x01, ((rgbCube - redGreenImages) >> 8) + 0x01, ((rgbCube - redGreenImages) >> 8) + 0x01, ((rgbCube - redGreenImages) >> 8) + 0x01, ((rgbCube - redGreenImages) >> 8) + 0x01, ((rgbCube - redGreenImages) >> 8) + 0x01, ((rgbCube - redGreenImages) >> 8) + 0x01
    db ((rgbCube - redGreenImages) >> 8) + 0x02, ((rgbCube - redGreenImages) >> 8) + 0x02, ((rgbCube - redGreenImages) >> 8) + 0x02, ((rgbCube - redGreenImages) >> 8) + 0x02, ((rgbCube - redGreenImages) >> 8) + 0x02, ((rgbCube - redGreenImages) >> 8) + 0x02, ((rgbCube - redGreenImages) >> 8) + 0x02, ((rgbCube - redGreenImages) >> 8) + 0x02
    db ((rgbCube - redGreenImages) >> 8) + 0x03, ((rgbCube - redGreenImages) >> 8) + 0x03, ((rgbCube - redGreenImages) >> 8) + 0x03, ((rgbCube - redGreenImages) >> 8) + 0x03, ((rgbCube - redGreenImages) >> 8) + 0x03, ((rgbCube - redGreenImages) >> 8) + 0x03, ((rgbCube - redGreenImages) >> 8) + 0x03, ((rgbCube - redGreenImages) >> 8) + 0x03
    db ((rgbCube - redGreenImages) >> 8) + 0x04, ((rgbCube - redGreenImages) >> 8) + 0x04, ((rgbCube - redGreenImages) >> 8) + 0x04, ((rgbCube - redGreenImages) >> 8) + 0x04, ((rgbCube - redGreenImages) >> 8) + 0x04, ((rgbCube - redGreenImages) >> 8) + 0x04, ((rgbCube - redGreenImages) >> 8) + 0x04, ((rgbCube - redGreenImages) >> 8) + 0x04
    db ((rgbCube - redGreenImages) >> 8) + 0x05, ((rgbCube - redGreenImages) >> 8) + 0x05, ((rgbCube - redGreenImages) >> 8) + 0x05, ((rgbCube - redGreenImages) >> 8) + 0x05, ((rgbCube - redGreenImages) >> 8) + 0x05, ((rgbCube - redGreenImages) >> 8) + 0x05, ((rgbCube - redGreenImages) >> 8) + 0x05, ((rgbCube - redGreenImages) >> 8) + 0x05
    db ((rgbCube - redGreenImages) >> 8) + 0x06, ((rgbCube - redGreenImages) >> 8) + 0x06, ((rgbCube - redGreenImages) >> 8) + 0x06, ((rgbCube - redGreenImages) >> 8) + 0x06, ((rgbCube - redGreenImages) >> 8) + 0x06, ((rgbCube - redGreenImages) >> 8) + 0x06, ((rgbCube - redGreenImages) >> 8) + 0x06, ((rgbCube - redGreenImages) >> 8) + 0x06
    db ((rgbCube - redGreenImages) >> 8) + 0x07, ((rgbCube - redGreenImages) >> 8) + 0x07, ((rgbCube - redGreenImages) >> 8) + 0x07, ((rgbCube - redGreenImages) >> 8) + 0x07, ((rgbCube - redGreenImages) >> 8) + 0x07, ((rgbCube - redGreenImages) >> 8) + 0x07, ((rgbCube - redGreenImages) >> 8) + 0x07, ((rgbCube - redGreenImages) >> 8) + 0x07
redTable1:
    db ((rgbCube - redGreenImages) >> 8) + 0x00, ((rgbCube - redGreenImages) >> 8) + 0x00, ((rgbCube - redGreenImages) >> 8) + 0x00, ((rgbCube - redGreenImages) >> 8) + 0x00, ((rgbCube - redGreenImages) >> 8) + 0x01, ((rgbCube - redGreenImages) >> 8) + 0x01, ((rgbCube - redGreenImages) >> 8) + 0x01, ((rgbCube - redGreenImages) >> 8) + 0x01
    db ((rgbCube - redGreenImages) >> 8) + 0x01, ((rgbCube - redGreenImages) >> 8) + 0x01, ((rgbCube - redGreenImages) >> 8) + 0x01, ((rgbCube - redGreenImages) >> 8) + 0x01, ((rgbCube - redGreenImages) >> 8) + 0x01, ((rgbCube - redGreenImages) >> 8) + 0x02, ((rgbCube - redGreenImages) >> 8) + 0x02, ((rgbCube - redGreenImages) >> 8) + 0x02
    db ((rgbCube - redGreenImages) >> 8) + 0x02, ((rgbCube - redGreenImages) >> 8) + 0x02, ((rgbCube - redGreenImages) >> 8) + 0x02, ((rgbCube - redGreenImages) >> 8) + 0x02, ((rgbCube - redGreenImages) >> 8) + 0x02, ((rgbCube - redGreenImages) >> 8) + 0x02, ((rgbCube - redGreenImages) >> 8) + 0x03, ((rgbCube - redGreenImages) >> 8) + 0x03
    db ((rgbCube - redGreenImages) >> 8) + 0x03, ((rgbCube - redGreenImages) >> 8) + 0x03, ((rgbCube - redGreenImages) >> 8) + 0x03, ((rgbCube - redGreenImages) >> 8) + 0x03, ((rgbCube - redGreenImages) >> 8) + 0x03, ((rgbCube - redGreenImages) >> 8) + 0x03, ((rgbCube - redGreenImages) >> 8) + 0x03, ((rgbCube - redGreenImages) >> 8) + 0x04
    db ((rgbCube - redGreenImages) >> 8) + 0x03, ((rgbCube - redGreenImages) >> 8) + 0x04, ((rgbCube - redGreenImages) >> 8) + 0x04, ((rgbCube - redGreenImages) >> 8) + 0x04, ((rgbCube - redGreenImages) >> 8) + 0x04, ((rgbCube - redGreenImages) >> 8) + 0x04, ((rgbCube - redGreenImages) >> 8) + 0x04, ((rgbCube - redGreenImages) >> 8) + 0x04
    db ((rgbCube - redGreenImages) >> 8) + 0x04, ((rgbCube - redGreenImages) >> 8) + 0x04, ((rgbCube - redGreenImages) >> 8) + 0x05, ((rgbCube - redGreenImages) >> 8) + 0x05, ((rgbCube - redGreenImages) >> 8) + 0x05, ((rgbCube - redGreenImages) >> 8) + 0x05, ((rgbCube - redGreenImages) >> 8) + 0x05, ((rgbCube - redGreenImages) >> 8) + 0x05
    db ((rgbCube - redGreenImages) >> 8) + 0x05, ((rgbCube - redGreenImages) >> 8) + 0x05, ((rgbCube - redGreenImages) >> 8) + 0x05, ((rgbCube - redGreenImages) >> 8) + 0x06, ((rgbCube - redGreenImages) >> 8) + 0x06, ((rgbCube - redGreenImages) >> 8) + 0x06, ((rgbCube - redGreenImages) >> 8) + 0x06, ((rgbCube - redGreenImages) >> 8) + 0x06
    db ((rgbCube - redGreenImages) >> 8) + 0x06, ((rgbCube - redGreenImages) >> 8) + 0x06, ((rgbCube - redGreenImages) >> 8) + 0x06, ((rgbCube - redGreenImages) >> 8) + 0x06, ((rgbCube - redGreenImages) >> 8) + 0x07, ((rgbCube - redGreenImages) >> 8) + 0x07, ((rgbCube - redGreenImages) >> 8) + 0x07, ((rgbCube - redGreenImages) >> 8) + 0x07
  dw 0x048E, 0x058E, 0x14B0, 0x158E, 0x158E, 0x1D1D, 0x1D1D, 0x1D1D
  dw 0x428E, 0x8F7F, 0x1E1D, 0x1F1D, 0x1F1D, 0x97B0, 0x7914, 0x9F7F
  dw 0x268E, 0x2D1D, 0x34B0, 0x35B0, 0xD314, 0x9AB0, 0xA914, 0xB914
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  dw 0x6A14, 0xAF7F, 0xBA14, 0xAB8E, 0xABB1, 0xBAB0, 0xBE7F, 0xBF7F
redTable2:
    db ((rgbCube - redGreenImages) >> 8) + 0x00, ((rgbCube - redGreenImages) >> 8) + 0x00, ((rgbCube - redGreenImages) >> 8) + 0x01, ((rgbCube - redGreenImages) >> 8) + 0x01, ((rgbCube - redGreenImages) >> 8) + 0x01, ((rgbCube - redGreenImages) >> 8) + 0x01, ((rgbCube - redGreenImages) >> 8) + 0x02, ((rgbCube - redGreenImages) >> 8) + 0x02
    db ((rgbCube - redGreenImages) >> 8) + 0x01, ((rgbCube - redGreenImages) >> 8) + 0x01, ((rgbCube - redGreenImages) >> 8) + 0x01, ((rgbCube - redGreenImages) >> 8) + 0x02, ((rgbCube - redGreenImages) >> 8) + 0x02, ((rgbCube - redGreenImages) >> 8) + 0x02, ((rgbCube - redGreenImages) >> 8) + 0x02, ((rgbCube - redGreenImages) >> 8) + 0x03
    db ((rgbCube - redGreenImages) >> 8) + 0x01, ((rgbCube - redGreenImages) >> 8) + 0x02, ((rgbCube - redGreenImages) >> 8) + 0x02, ((rgbCube - redGreenImages) >> 8) + 0x02, ((rgbCube - redGreenImages) >> 8) + 0x03, ((rgbCube - redGreenImages) >> 8) + 0x03, ((rgbCube - redGreenImages) >> 8) + 0x03, ((rgbCube - redGreenImages) >> 8) + 0x03
    db ((rgbCube - redGreenImages) >> 8) + 0x02, ((rgbCube - redGreenImages) >> 8) + 0x02, ((rgbCube - redGreenImages) >> 8) + 0x03, ((rgbCube - redGreenImages) >> 8) + 0x03, ((rgbCube - redGreenImages) >> 8) + 0x03, ((rgbCube - redGreenImages) >> 8) + 0x04, ((rgbCube - redGreenImages) >> 8) + 0x04, ((rgbCube - redGreenImages) >> 8) + 0x04
    db ((rgbCube - redGreenImages) >> 8) + 0x03, ((rgbCube - redGreenImages) >> 8) + 0x03, ((rgbCube - redGreenImages) >> 8) + 0x03, ((rgbCube - redGreenImages) >> 8) + 0x04, ((rgbCube - redGreenImages) >> 8) + 0x04, ((rgbCube - redGreenImages) >> 8) + 0x04, ((rgbCube - redGreenImages) >> 8) + 0x05, ((rgbCube - redGreenImages) >> 8) + 0x05
    db ((rgbCube - redGreenImages) >> 8) + 0x04, ((rgbCube - redGreenImages) >> 8) + 0x04, ((rgbCube - redGreenImages) >> 8) + 0x04, ((rgbCube - redGreenImages) >> 8) + 0x04, ((rgbCube - redGreenImages) >> 8) + 0x05, ((rgbCube - redGreenImages) >> 8) + 0x05, ((rgbCube - redGreenImages) >> 8) + 0x05, ((rgbCube - redGreenImages) >> 8) + 0x06
    db ((rgbCube - redGreenImages) >> 8) + 0x04, ((rgbCube - redGreenImages) >> 8) + 0x05, ((rgbCube - redGreenImages) >> 8) + 0x05, ((rgbCube - redGreenImages) >> 8) + 0x05, ((rgbCube - redGreenImages) >> 8) + 0x05, ((rgbCube - redGreenImages) >> 8) + 0x06, ((rgbCube - redGreenImages) >> 8) + 0x06, ((rgbCube - redGreenImages) >> 8) + 0x06
    db ((rgbCube - redGreenImages) >> 8) + 0x05, ((rgbCube - redGreenImages) >> 8) + 0x05, ((rgbCube - redGreenImages) >> 8) + 0x06, ((rgbCube - redGreenImages) >> 8) + 0x06, ((rgbCube - redGreenImages) >> 8) + 0x06, ((rgbCube - redGreenImages) >> 8) + 0x06, ((rgbCube - redGreenImages) >> 8) + 0x07, ((rgbCube - redGreenImages) >> 8) + 0x07
redTable3:
    db ((rgbCube - redGreenImages) >> 8) + 0x00, ((rgbCube - redGreenImages) >> 8) + 0x00, ((rgbCube - redGreenImages) >> 8) + 0x01, ((rgbCube - redGreenImages) >> 8) + 0x01, ((rgbCube - redGreenImages) >> 8) + 0x02, ((rgbCube - redGreenImages) >> 8) + 0x02, ((rgbCube - redGreenImages) >> 8) + 0x03, ((rgbCube - redGreenImages) >> 8) + 0x03
    db ((rgbCube - redGreenImages) >> 8) + 0x01, ((rgbCube - redGreenImages) >> 8) + 0x01, ((rgbCube - redGreenImages) >> 8) + 0x01, ((rgbCube - redGreenImages) >> 8) + 0x02, ((rgbCube - redGreenImages) >> 8) + 0x02, ((rgbCube - redGreenImages) >> 8) + 0x03, ((rgbCube - redGreenImages) >> 8) + 0x03, ((rgbCube - redGreenImages) >> 8) + 0x04
    db ((rgbCube - redGreenImages) >> 8) + 0x01, ((rgbCube - redGreenImages) >> 8) + 0x02, ((rgbCube - redGreenImages) >> 8) + 0x02, ((rgbCube - redGreenImages) >> 8) + 0x02, ((rgbCube - redGreenImages) >> 8) + 0x03, ((rgbCube - redGreenImages) >> 8) + 0x03, ((rgbCube - redGreenImages) >> 8) + 0x04, ((rgbCube - redGreenImages) >> 8) + 0x04
    db ((rgbCube - redGreenImages) >> 8) + 0x02, ((rgbCube - redGreenImages) >> 8) + 0x02, ((rgbCube - redGreenImages) >> 8) + 0x03, ((rgbCube - redGreenImages) >> 8) + 0x03, ((rgbCube - redGreenImages) >> 8) + 0x03, ((rgbCube - redGreenImages) >> 8) + 0x04, ((rgbCube - redGreenImages) >> 8) + 0x04, ((rgbCube - redGreenImages) >> 8) + 0x05
    db ((rgbCube - redGreenImages) >> 8) + 0x02, ((rgbCube - redGreenImages) >> 8) + 0x03, ((rgbCube - redGreenImages) >> 8) + 0x03, ((rgbCube - redGreenImages) >> 8) + 0x04, ((rgbCube - redGreenImages) >> 8) + 0x04, ((rgbCube - redGreenImages) >> 8) + 0x04, ((rgbCube - redGreenImages) >> 8) + 0x05, ((rgbCube - redGreenImages) >> 8) + 0x05
    db ((rgbCube - redGreenImages) >> 8) + 0x03, ((rgbCube - redGreenImages) >> 8) + 0x03, ((rgbCube - redGreenImages) >> 8) + 0x04, ((rgbCube - redGreenImages) >> 8) + 0x04, ((rgbCube - redGreenImages) >> 8) + 0x05, ((rgbCube - redGreenImages) >> 8) + 0x05, ((rgbCube - redGreenImages) >> 8) + 0x05, ((rgbCube - redGreenImages) >> 8) + 0x06
    db ((rgbCube - redGreenImages) >> 8) + 0x03, ((rgbCube - redGreenImages) >> 8) + 0x04, ((rgbCube - redGreenImages) >> 8) + 0x04, ((rgbCube - redGreenImages) >> 8) + 0x05, ((rgbCube - redGreenImages) >> 8) + 0x05, ((rgbCube - redGreenImages) >> 8) + 0x06, ((rgbCube - redGreenImages) >> 8) + 0x06, ((rgbCube - redGreenImages) >> 8) + 0x06
    db ((rgbCube - redGreenImages) >> 8) + 0x04, ((rgbCube - redGreenImages) >> 8) + 0x04, ((rgbCube - redGreenImages) >> 8) + 0x05, ((rgbCube - redGreenImages) >> 8) + 0x05, ((rgbCube - redGreenImages) >> 8) + 0x06, ((rgbCube - redGreenImages) >> 8) + 0x06, ((rgbCube - redGreenImages) >> 8) + 0x07, ((rgbCube - redGreenImages) >> 8) + 0x07
  dw 0x40B0, 0x41B0, 0x50B0, 0x51B0, 0x51B0, 0x51B0, 0x591D, 0x59B0
  dw 0x2614, 0x4B1D, 0x52B0, 0x538E, 0xB514, 0x9CB0, 0xC914, 0xD914
  dw 0x628E, 0xB614, 0x70B0, 0x71B0, 0x79B0, 0x798E, 0xE914, 0xF914
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  dw 0x2E8E, 0xEA14, 0xFA14, 0xAFB0, 0xBEB0, 0xBEB0, 0xEB14, 0xFB14
redTable4:
    db ((rgbCube - redGreenImages) >> 8) + 0x00, ((rgbCube - redGreenImages) >> 8) + 0x01, ((rgbCube - redGreenImages) >> 8) + 0x01, ((rgbCube - redGreenImages) >> 8) + 0x02, ((rgbCube - redGreenImages) >> 8) + 0x02, ((rgbCube - redGreenImages) >> 8) + 0x03, ((rgbCube - redGreenImages) >> 8) + 0x03, ((rgbCube - redGreenImages) >> 8) + 0x04
    db ((rgbCube - redGreenImages) >> 8) + 0x00, ((rgbCube - redGreenImages) >> 8) + 0x01, ((rgbCube - redGreenImages) >> 8) + 0x02, ((rgbCube - redGreenImages) >> 8) + 0x02, ((rgbCube - redGreenImages) >> 8) + 0x03, ((rgbCube - redGreenImages) >> 8) + 0x03, ((rgbCube - redGreenImages) >> 8) + 0x04, ((rgbCube - redGreenImages) >> 8) + 0x04
    db ((rgbCube - redGreenImages) >> 8) + 0x01, ((rgbCube - redGreenImages) >> 8) + 0x01, ((rgbCube - redGreenImages) >> 8) + 0x02, ((rgbCube - redGreenImages) >> 8) + 0x03, ((rgbCube - redGreenImages) >> 8) + 0x03, ((rgbCube - redGreenImages) >> 8) + 0x04, ((rgbCube - redGreenImages) >> 8) + 0x04, ((rgbCube - redGreenImages) >> 8) + 0x05
    db ((rgbCube - redGreenImages) >> 8) + 0x01, ((rgbCube - redGreenImages) >> 8) + 0x02, ((rgbCube - redGreenImages) >> 8) + 0x02, ((rgbCube - redGreenImages) >> 8) + 0x03, ((rgbCube - redGreenImages) >> 8) + 0x04, ((rgbCube - redGreenImages) >> 8) + 0x04, ((rgbCube - redGreenImages) >> 8) + 0x05, ((rgbCube - redGreenImages) >> 8) + 0x05
    db ((rgbCube - redGreenImages) >> 8) + 0x02, ((rgbCube - redGreenImages) >> 8) + 0x02, ((rgbCube - redGreenImages) >> 8) + 0x03, ((rgbCube - redGreenImages) >> 8) + 0x03, ((rgbCube - redGreenImages) >> 8) + 0x04, ((rgbCube - redGreenImages) >> 8) + 0x05, ((rgbCube - redGreenImages) >> 8) + 0x05, ((rgbCube - redGreenImages) >> 8) + 0x06
    db ((rgbCube - redGreenImages) >> 8) + 0x02, ((rgbCube - redGreenImages) >> 8) + 0x03, ((rgbCube - redGreenImages) >> 8) + 0x03, ((rgbCube - redGreenImages) >> 8) + 0x04, ((rgbCube - redGreenImages) >> 8) + 0x04, ((rgbCube - redGreenImages) >> 8) + 0x05, ((rgbCube - redGreenImages) >> 8) + 0x06, ((rgbCube - redGreenImages) >> 8) + 0x06
    db ((rgbCube - redGreenImages) >> 8) + 0x03, ((rgbCube - redGreenImages) >> 8) + 0x03, ((rgbCube - redGreenImages) >> 8) + 0x04, ((rgbCube - redGreenImages) >> 8) + 0x04, ((rgbCube - redGreenImages) >> 8) + 0x05, ((rgbCube - redGreenImages) >> 8) + 0x05, ((rgbCube - redGreenImages) >> 8) + 0x06, ((rgbCube - redGreenImages) >> 8) + 0x07
    db ((rgbCube - redGreenImages) >> 8) + 0x03, ((rgbCube - redGreenImages) >> 8) + 0x04, ((rgbCube - redGreenImages) >> 8) + 0x04, ((rgbCube - redGreenImages) >> 8) + 0x05, ((rgbCube - redGreenImages) >> 8) + 0x05, ((rgbCube - redGreenImages) >> 8) + 0x06, ((rgbCube - redGreenImages) >> 8) + 0x06, ((rgbCube - redGreenImages) >> 8) + 0x07
redTable5:
    db ((rgbCube - redGreenImages) >> 8) + 0x00, ((rgbCube - redGreenImages) >> 8) + 0x01, ((rgbCube - redGreenImages) >> 8) + 0x01, ((rgbCube - redGreenImages) >> 8) + 0x02, ((rgbCube - redGreenImages) >> 8) + 0x03, ((rgbCube - redGreenImages) >> 8) + 0x04, ((rgbCube - redGreenImages) >> 8) + 0x04, ((rgbCube - redGreenImages) >> 8) + 0x05
    db ((rgbCube - redGreenImages) >> 8) + 0x00, ((rgbCube - redGreenImages) >> 8) + 0x01, ((rgbCube - redGreenImages) >> 8) + 0x02, ((rgbCube - redGreenImages) >> 8) + 0x02, ((rgbCube - redGreenImages) >> 8) + 0x03, ((rgbCube - redGreenImages) >> 8) + 0x04, ((rgbCube - redGreenImages) >> 8) + 0x05, ((rgbCube - redGreenImages) >> 8) + 0x05
    db ((rgbCube - redGreenImages) >> 8) + 0x01, ((rgbCube - redGreenImages) >> 8) + 0x01, ((rgbCube - redGreenImages) >> 8) + 0x02, ((rgbCube - redGreenImages) >> 8) + 0x03, ((rgbCube - redGreenImages) >> 8) + 0x03, ((rgbCube - redGreenImages) >> 8) + 0x04, ((rgbCube - redGreenImages) >> 8) + 0x05, ((rgbCube - redGreenImages) >> 8) + 0x06
    db ((rgbCube - redGreenImages) >> 8) + 0x01, ((rgbCube - redGreenImages) >> 8) + 0x02, ((rgbCube - redGreenImages) >> 8) + 0x02, ((rgbCube - redGreenImages) >> 8) + 0x03, ((rgbCube - redGreenImages) >> 8) + 0x04, ((rgbCube - redGreenImages) >> 8) + 0x04, ((rgbCube - redGreenImages) >> 8) + 0x05, ((rgbCube - redGreenImages) >> 8) + 0x06
    db ((rgbCube - redGreenImages) >> 8) + 0x01, ((rgbCube - redGreenImages) >> 8) + 0x02, ((rgbCube - redGreenImages) >> 8) + 0x03, ((rgbCube - redGreenImages) >> 8) + 0x03, ((rgbCube - redGreenImages) >> 8) + 0x04, ((rgbCube - redGreenImages) >> 8) + 0x05, ((rgbCube - redGreenImages) >> 8) + 0x05, ((rgbCube - redGreenImages) >> 8) + 0x06
    db ((rgbCube - redGreenImages) >> 8) + 0x01, ((rgbCube - redGreenImages) >> 8) + 0x02, ((rgbCube - redGreenImages) >> 8) + 0x03, ((rgbCube - redGreenImages) >> 8) + 0x04, ((rgbCube - redGreenImages) >> 8) + 0x04, ((rgbCube - redGreenImages) >> 8) + 0x05, ((rgbCube - redGreenImages) >> 8) + 0x06, ((rgbCube - redGreenImages) >> 8) + 0x06
    db ((rgbCube - redGreenImages) >> 8) + 0x02, ((rgbCube - redGreenImages) >> 8) + 0x02, ((rgbCube - redGreenImages) >> 8) + 0x03, ((rgbCube - redGreenImages) >> 8) + 0x04, ((rgbCube - redGreenImages) >> 8) + 0x05, ((rgbCube - redGreenImages) >> 8) + 0x05, ((rgbCube - redGreenImages) >> 8) + 0x06, ((rgbCube - redGreenImages) >> 8) + 0x07
    db ((rgbCube - redGreenImages) >> 8) + 0x02, ((rgbCube - redGreenImages) >> 8) + 0x03, ((rgbCube - redGreenImages) >> 8) + 0x03, ((rgbCube - redGreenImages) >> 8) + 0x04, ((rgbCube - redGreenImages) >> 8) + 0x05, ((rgbCube - redGreenImages) >> 8) + 0x06, ((rgbCube - redGreenImages) >> 8) + 0x06, ((rgbCube - redGreenImages) >> 8) + 0x07
  dw 0x4414, 0x458E, 0x54B0, 0x5514, 0x5514, 0x5D7F, 0x5D7F, 0x5D1D
  dw 0x6E7F, 0x4F1D, 0x5E1D, 0x578E, 0x5F1D, 0x9C8E, 0x9D8E, 0x9D8E
  dw 0xE614, 0x678E, 0x74B0, 0x2D8E, 0x3D8E, 0x3D8E, 0x3D8E, 0x9FB0
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  dw 0x2EB1, 0xAE8E, 0xAFB0, 0xAF8E, 0xBE8E, 0xBE8E, 0xBF8E, 0xBF8E
redTable6:
    db ((rgbCube - redGreenImages) >> 8) + 0x00, ((rgbCube - redGreenImages) >> 8) + 0x01, ((rgbCube - redGreenImages) >> 8) + 0x02, ((rgbCube - redGreenImages) >> 8) + 0x03, ((rgbCube - redGreenImages) >> 8) + 0x03, ((rgbCube - redGreenImages) >> 8) + 0x04, ((rgbCube - redGreenImages) >> 8) + 0x05, ((rgbCube - redGreenImages) >> 8) + 0x06
    db ((rgbCube - redGreenImages) >> 8) + 0x00, ((rgbCube - redGreenImages) >> 8) + 0x01, ((rgbCube - redGreenImages) >> 8) + 0x02, ((rgbCube - redGreenImages) >> 8) + 0x03, ((rgbCube - redGreenImages) >> 8) + 0x04, ((rgbCube - redGreenImages) >> 8) + 0x04, ((rgbCube - redGreenImages) >> 8) + 0x05, ((rgbCube - redGreenImages) >> 8) + 0x06
    db ((rgbCube - redGreenImages) >> 8) + 0x00, ((rgbCube - redGreenImages) >> 8) + 0x01, ((rgbCube - redGreenImages) >> 8) + 0x02, ((rgbCube - redGreenImages) >> 8) + 0x03, ((rgbCube - redGreenImages) >> 8) + 0x04, ((rgbCube - redGreenImages) >> 8) + 0x05, ((rgbCube - redGreenImages) >> 8) + 0x05, ((rgbCube - redGreenImages) >> 8) + 0x06
    db ((rgbCube - redGreenImages) >> 8) + 0x00, ((rgbCube - redGreenImages) >> 8) + 0x01, ((rgbCube - redGreenImages) >> 8) + 0x02, ((rgbCube - redGreenImages) >> 8) + 0x03, ((rgbCube - redGreenImages) >> 8) + 0x04, ((rgbCube - redGreenImages) >> 8) + 0x05, ((rgbCube - redGreenImages) >> 8) + 0x06, ((rgbCube - redGreenImages) >> 8) + 0x06
    db ((rgbCube - redGreenImages) >> 8) + 0x01, ((rgbCube - redGreenImages) >> 8) + 0x01, ((rgbCube - redGreenImages) >> 8) + 0x02, ((rgbCube - redGreenImages) >> 8) + 0x03, ((rgbCube - redGreenImages) >> 8) + 0x04, ((rgbCube - redGreenImages) >> 8) + 0x05, ((rgbCube - redGreenImages) >> 8) + 0x06, ((rgbCube - redGreenImages) >> 8) + 0x07
    db ((rgbCube - redGreenImages) >> 8) + 0x01, ((rgbCube - redGreenImages) >> 8) + 0x02, ((rgbCube - redGreenImages) >> 8) + 0x02, ((rgbCube - redGreenImages) >> 8) + 0x03, ((rgbCube - redGreenImages) >> 8) + 0x04, ((rgbCube - redGreenImages) >> 8) + 0x05, ((rgbCube - redGreenImages) >> 8) + 0x06, ((rgbCube - redGreenImages) >> 8) + 0x07
    db ((rgbCube - redGreenImages) >> 8) + 0x01, ((rgbCube - redGreenImages) >> 8) + 0x02, ((rgbCube - redGreenImages) >> 8) + 0x03, ((rgbCube - redGreenImages) >> 8) + 0x03, ((rgbCube - redGreenImages) >> 8) + 0x04, ((rgbCube - redGreenImages) >> 8) + 0x05, ((rgbCube - redGreenImages) >> 8) + 0x06, ((rgbCube - redGreenImages) >> 8) + 0x07
    db ((rgbCube - redGreenImages) >> 8) + 0x01, ((rgbCube - redGreenImages) >> 8) + 0x02, ((rgbCube - redGreenImages) >> 8) + 0x03, ((rgbCube - redGreenImages) >> 8) + 0x04, ((rgbCube - redGreenImages) >> 8) + 0x04, ((rgbCube - redGreenImages) >> 8) + 0x05, ((rgbCube - redGreenImages) >> 8) + 0x06, ((rgbCube - redGreenImages) >> 8) + 0x07
redTable7:
    db ((rgbCube - redGreenImages) >> 8) + 0x00, ((rgbCube - redGreenImages) >> 8) + 0x01, ((rgbCube - redGreenImages) >> 8) + 0x02, ((rgbCube - redGreenImages) >> 8) + 0x03, ((rgbCube - redGreenImages) >> 8) + 0x04, ((rgbCube - redGreenImages) >> 8) + 0x05, ((rgbCube - redGreenImages) >> 8) + 0x06, ((rgbCube - redGreenImages) >> 8) + 0x07
    db ((rgbCube - redGreenImages) >> 8) + 0x00, ((rgbCube - redGreenImages) >> 8) + 0x01, ((rgbCube - redGreenImages) >> 8) + 0x02, ((rgbCube - redGreenImages) >> 8) + 0x03, ((rgbCube - redGreenImages) >> 8) + 0x04, ((rgbCube - redGreenImages) >> 8) + 0x05, ((rgbCube - redGreenImages) >> 8) + 0x06, ((rgbCube - redGreenImages) >> 8) + 0x07
    db ((rgbCube - redGreenImages) >> 8) + 0x00, ((rgbCube - redGreenImages) >> 8) + 0x01, ((rgbCube - redGreenImages) >> 8) + 0x02, ((rgbCube - redGreenImages) >> 8) + 0x03, ((rgbCube - redGreenImages) >> 8) + 0x04, ((rgbCube - redGreenImages) >> 8) + 0x05, ((rgbCube - redGreenImages) >> 8) + 0x06, ((rgbCube - redGreenImages) >> 8) + 0x07
    db ((rgbCube - redGreenImages) >> 8) + 0x00, ((rgbCube - redGreenImages) >> 8) + 0x01, ((rgbCube - redGreenImages) >> 8) + 0x02, ((rgbCube - redGreenImages) >> 8) + 0x03, ((rgbCube - redGreenImages) >> 8) + 0x04, ((rgbCube - redGreenImages) >> 8) + 0x05, ((rgbCube - redGreenImages) >> 8) + 0x06, ((rgbCube - redGreenImages) >> 8) + 0x07
    db ((rgbCube - redGreenImages) >> 8) + 0x00, ((rgbCube - redGreenImages) >> 8) + 0x01, ((rgbCube - redGreenImages) >> 8) + 0x02, ((rgbCube - redGreenImages) >> 8) + 0x03, ((rgbCube - redGreenImages) >> 8) + 0x04, ((rgbCube - redGreenImages) >> 8) + 0x05, ((rgbCube - redGreenImages) >> 8) + 0x06, ((rgbCube - redGreenImages) >> 8) + 0x07
    db ((rgbCube - redGreenImages) >> 8) + 0x00, ((rgbCube - redGreenImages) >> 8) + 0x01, ((rgbCube - redGreenImages) >> 8) + 0x02, ((rgbCube - redGreenImages) >> 8) + 0x03, ((rgbCube - redGreenImages) >> 8) + 0x04, ((rgbCube - redGreenImages) >> 8) + 0x05, ((rgbCube - redGreenImages) >> 8) + 0x06, ((rgbCube - redGreenImages) >> 8) + 0x07
    db ((rgbCube - redGreenImages) >> 8) + 0x00, ((rgbCube - redGreenImages) >> 8) + 0x01, ((rgbCube - redGreenImages) >> 8) + 0x02, ((rgbCube - redGreenImages) >> 8) + 0x03, ((rgbCube - redGreenImages) >> 8) + 0x04, ((rgbCube - redGreenImages) >> 8) + 0x05, ((rgbCube - redGreenImages) >> 8) + 0x06, ((rgbCube - redGreenImages) >> 8) + 0x07
    db ((rgbCube - redGreenImages) >> 8) + 0x00, ((rgbCube - redGreenImages) >> 8) + 0x01, ((rgbCube - redGreenImages) >> 8) + 0x02, ((rgbCube - redGreenImages) >> 8) + 0x03, ((rgbCube - redGreenImages) >> 8) + 0x04, ((rgbCube - redGreenImages) >> 8) + 0x05, ((rgbCube - redGreenImages) >> 8) + 0x06, ((rgbCube - redGreenImages) >> 8) + 0x07
  dw 0x4414, 0x458E, 0x54B0, 0x5514, 0x5D7F, 0x5D1D, 0x5D1D, 0x5DB0
  dw 0x6E7F, 0x4F1D, 0xE514, 0x5F1D, 0xF514, 0xD2B0, 0xD3B0, 0x9DB1
  dw 0xE614, 0xF614, 0x6FB0, 0x2DB1, 0x7DB0, 0x3DB1, 0xD38E, 0xDBB0
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  dw 0xE28E, 0xAEB1, 0xEBB0, 0xEB8E, 0xAFB1, 0xFA8E, 0xBFB1, 0xBFB1
greenTable0:
    db 0x00, 0x00, 0x00, 0x00, 0x00, 0x00, 0x00, 0x00
    db 0x10, 0x10, 0x10, 0x10, 0x10, 0x10, 0x10, 0x10
    db 0x20, 0x20, 0x20, 0x20, 0x20, 0x20, 0x20, 0x20
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    db 0x70, 0x70, 0x70, 0x70, 0x70, 0x70, 0x70, 0x70
greenTable1:
    db 0x00, 0x00, 0x00, 0x00, 0x10, 0x10, 0x10, 0x10
    db 0x10, 0x10, 0x10, 0x10, 0x10, 0x20, 0x20, 0x20
    db 0x20, 0x20, 0x20, 0x20, 0x20, 0x20, 0x30, 0x30
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  dw 0xE2B0, 0xEAB0, 0xEBB0, 0xEB8E, 0xFA8E, 0xFAB0, 0xFAB0, 0xFBB0
greenTable2:
    db 0x00, 0x00, 0x10, 0x10, 0x10, 0x10, 0x20, 0x20
    db 0x10, 0x10, 0x10, 0x20, 0x20, 0x20, 0x20, 0x30
    db 0x10, 0x20, 0x20, 0x20, 0x30, 0x30, 0x30, 0x30
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    db 0x50, 0x50, 0x60, 0x60, 0x60, 0x60, 0x70, 0x70
greenTable3:
    db 0x00, 0x00, 0x10, 0x10, 0x20, 0x20, 0x30, 0x30
    db 0x10, 0x10, 0x10, 0x20, 0x20, 0x30, 0x30, 0x40
    db 0x10, 0x20, 0x20, 0x20, 0x30, 0x30, 0x40, 0x40
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  dw 0x2E14, 0xEB7F, 0xBE14, 0xEF8E, 0xEFB1, 0xFAB0, 0xAF14, 0xBF14
greenTable4:
    db 0x00, 0x10, 0x10, 0x20, 0x20, 0x30, 0x30, 0x40
    db 0x00, 0x10, 0x20, 0x20, 0x30, 0x30, 0x40, 0x40
    db 0x10, 0x10, 0x20, 0x30, 0x30, 0x40, 0x40, 0x50
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    db 0x30, 0x40, 0x40, 0x50, 0x50, 0x60, 0x60, 0x70
greenTable5:
    db 0x00, 0x10, 0x10, 0x20, 0x30, 0x40, 0x40, 0x50
    db 0x00, 0x10, 0x20, 0x20, 0x30, 0x40, 0x50, 0x50
    db 0x10, 0x10, 0x20, 0x30, 0x30, 0x40, 0x50, 0x60
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  dw 0xE67F, 0xEF7F, 0xFE14, 0xEF8E, 0xEFB1, 0xFEB0, 0xEF14, 0xFF14
greenTable6:
    db 0x00, 0x10, 0x20, 0x30, 0x30, 0x40, 0x50, 0x60
    db 0x00, 0x10, 0x20, 0x30, 0x40, 0x40, 0x50, 0x60
    db 0x00, 0x10, 0x20, 0x30, 0x40, 0x50, 0x50, 0x60
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    db 0x10, 0x20, 0x30, 0x40, 0x40, 0x50, 0x60, 0x70
greenTable7:
    db 0x00, 0x10, 0x20, 0x30, 0x40, 0x50, 0x60, 0x70
    db 0x00, 0x10, 0x20, 0x30, 0x40, 0x50, 0x60, 0x70
    db 0x00, 0x10, 0x20, 0x30, 0x40, 0x50, 0x60, 0x70
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    db 0x00, 0x10, 0x20, 0x30, 0x40, 0x50, 0x60, 0x70
blueTable0:
    db 0x00, 0x00, 0x00, 0x00, 0x00, 0x00, 0x00, 0x00
    db 0x02, 0x02, 0x02, 0x02, 0x02, 0x02, 0x02, 0x02
    db 0x04, 0x04, 0x04, 0x04, 0x04, 0x04, 0x04, 0x04
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    db 0x0E, 0x0E, 0x0E, 0x0E, 0x0E, 0x0E, 0x0E, 0x0E
blueTable1:
    db 0x00, 0x00, 0x00, 0x00, 0x02, 0x02, 0x02, 0x02
    db 0x02, 0x02, 0x02, 0x02, 0x02, 0x04, 0x04, 0x04
    db 0x04, 0x04, 0x04, 0x04, 0x04, 0x04, 0x06, 0x06
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    db 0x0C, 0x0C, 0x0C, 0x0C, 0x0E, 0x0E, 0x0E, 0x0E
blueTable2:
    db 0x00, 0x00, 0x02, 0x02, 0x02, 0x02, 0x04, 0x04
    db 0x02, 0x02, 0x02, 0x04, 0x04, 0x04, 0x04, 0x06
    db 0x02, 0x04, 0x04, 0x04, 0x06, 0x06, 0x06, 0x06
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    db 0x0A, 0x0A, 0x0C, 0x0C, 0x0C, 0x0C, 0x0E, 0x0E
blueTable3:
    db 0x00, 0x00, 0x02, 0x02, 0x04, 0x04, 0x06, 0x06
    db 0x02, 0x02, 0x02, 0x04, 0x04, 0x06, 0x06, 0x08
    db 0x02, 0x04, 0x04, 0x04, 0x06, 0x06, 0x08, 0x08
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    db 0x08, 0x08, 0x0A, 0x0A, 0x0C, 0x0C, 0x0E, 0x0E
blueTable4:
    db 0x00, 0x02, 0x02, 0x04, 0x04, 0x06, 0x06, 0x08
    db 0x00, 0x02, 0x04, 0x04, 0x06, 0x06, 0x08, 0x08
    db 0x02, 0x02, 0x04, 0x06, 0x06, 0x08, 0x08, 0x0A
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    db 0x06, 0x08, 0x08, 0x0A, 0x0A, 0x0C, 0x0C, 0x0E
blueTable5:
    db 0x00, 0x02, 0x02, 0x04, 0x06, 0x08, 0x08, 0x0A
    db 0x00, 0x02, 0x04, 0x04, 0x06, 0x08, 0x0A, 0x0A
    db 0x02, 0x02, 0x04, 0x06, 0x06, 0x08, 0x0A, 0x0C
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    db 0x04, 0x06, 0x06, 0x08, 0x0A, 0x0C, 0x0C, 0x0E
blueTable6:
    db 0x00, 0x02, 0x04, 0x06, 0x06, 0x08, 0x0A, 0x0C
    db 0x00, 0x02, 0x04, 0x06, 0x08, 0x08, 0x0A, 0x0C
    db 0x00, 0x02, 0x04, 0x06, 0x08, 0x0A, 0x0A, 0x0C
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    db 0x02, 0x04, 0x06, 0x08, 0x08, 0x0A, 0x0C, 0x0E
blueTable7:
    db 0x00, 0x02, 0x04, 0x06, 0x08, 0x0A, 0x0C, 0x0E
    db 0x00, 0x02, 0x04, 0x06, 0x08, 0x0A, 0x0C, 0x0E
    db 0x00, 0x02, 0x04, 0x06, 0x08, 0x0A, 0x0C, 0x0E
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    db 0x00, 0x02, 0x04, 0x06, 0x08, 0x0A, 0x0C, 0x0E
%endmacro
